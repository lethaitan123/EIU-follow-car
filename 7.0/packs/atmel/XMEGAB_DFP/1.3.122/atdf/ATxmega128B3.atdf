# ATxmega128B3 device description
Architecture: AVR8_XMEGA; Family: AVR XMEGA
Programming and debug interfaces: PDI, JTAG
Registers are 8-bit, access not given, no defined reset value unless marked. A register's access mark holds for its fields unless they carry their own. Offsets are from the block's base; lines under a group give offsets from that group; [hi:lo] are bit positions; {n}, {i} and the like mark numbered series; 'fields as' and 'values as' point back to an identical list; <NAME> marks a mode.

## Ordering variants
ATxmega128B3-AU: TQFP64, pinout QFP_QFN_64, up to 32 MHz, -40 to 85 C, 1.6 to 3.6 V
ATxmega128B3-MH: QFN64, pinout QFP_QFN_64, up to 32 MHz, -40 to 85 C, 1.6 to 3.6 V
ATxmega128B3-MCU: DRQFN64, pinout DRQFN_64, up to 32 MHz, -40 to 85 C, 1.6 to 3.6 V

## Memory
prog space: start 0x00000 size 0x22000, little endian
  0x00000 APP_SECTION size 0x20000 flash, rw, executable, page 256
  0x1E000 APPTABLE_SECTION size 0x2000 flash, rw, executable, page 256
  0x20000 BOOT_SECTION size 0x2000 flash, rw, executable, page 256
data space: start 0x0000 size 0x4000, little endian
  0x0000 IO size 0x1000 io, rw
  0x1000 MAPPED_EEPROM size 0x0800 eeprom, rw
  0x2000 INTERNAL_SRAM size 0x2000 ram, rw
eeprom space: start 0x00000 size 0x0800
  0x00000 EEPROM size 0x0800 eeprom, rw, page 32
signatures space: start 0x0000 size 0x0003
  0x0000 SIGNATURES size 0x0003 signatures, ro
fuses space: start 0x0000 size 0x0006
  0x0000 FUSES size 0x0006 fuses, rw
lockbits space: start 0x0000 size 0x0001
  0x0000 LOCKBITS size 0x0001 lockbits, rw
user_signatures space: start 0x0000 size 0x0100
  0x0000 USER_SIGNATURES size 0x0100 user_signatures, rw, page 256
prod_signatures space: start 0x0000 size 0x0034
  0x0000 PROD_SIGNATURES size 0x0034 other, ro, page 256

## Peripheral instances (address, pins/pin function, parameters)
GPIO at 0x0000
VPORT{n} at {0x10+4n} (VPORT) (n=0..3)
OCD at 0x002E
CPU at 0x0030
  parameters: CORE_VERSION=V3XJ
CLK at 0x0040
  pins: EXTCLK{n} PC{n}/EXTERNAL_CLOCK (n=0..7)
SLEEP at 0x0048
OSC at 0x0050
  pins: XTAL2 PR0/XTAL; XTAL1 PR1/XTAL; TOSC2 PR0/TOSC; TOSC1 PR1/TOSC
DFLLRC32M at 0x0060 (DFLL)
DFLLRC2M at 0x0068 (DFLL)
PR at 0x0070
RST at 0x0078
WDT at 0x0080
MCU at 0x0090
PMIC at 0x00A0
PORTCFG at 0x00B0
  pins: CLKOUT PD7/CLKOUTC; EVOUT PD7/EVOUTC; RTCOUT PD6/RTCOUTC
  pin routing set by: CLKOUT, EVOUT, RTCOUT
AES at 0x0C0
CRC at 0x0D0
DMA at 0x0100
EVSYS at 0x0180
NVM at 0x01C0
ADCB at 0x0240 (ADC)
  pins: ADC{n} PB{n} (n=0..7); REFB0 PB0/AREF
ACB at 0x0390 (AC)
  pins: AC{n} PB{n} (n=0..7); ACOUT1 PB6/ACOUT; ACOUT0 PB7/ACOUT
RTC at 0x0400
TWIC at 0x480 (TWI)
  pins: SDA PC0; SCL PC1
USB at 0x4C0
  pins: DN PD0; DP PD1
PORTB at 0x0620 (PORT)
  pins: P{n} PB{n} (n=0..7)
PORTC at 0x0640 (PORT)
  pins: P{n} PC{n} (n=0..7)
PORTD at 0x0660 (PORT)
  pins: P0 PD0; P1 PD1
PORTG at 0x06C0 (PORT)
  pins: P{n} PG{n} (n=0..7)
PORTM at 0x0760 (PORT)
  pins: P{n} PM{n} (n=0..7)
PORTR at 0x07E0 (PORT)
  pins: P0 PR0; P1 PR1
TCC0 at 0x800 (TC0)
  pins: OC0A PC0/TC0 or PC4/TC0_ALT; OC0B PC1/TC0 or PC5/TC0_ALT; OC0C PC2/TC0 or PC6/TC0_ALT; OC0D PC3/TC0 or PC7/TC0_ALT
  pin routing set by: TC0A, TC0B, TC0C, TC0D
TCC1 at 0x840 (TC1)
  pins: OC1A PC4/TC1; OC1B PC5/TC1
TCC2 at 0x800 (TC2)
  pins: LOC2A PC0; LOC2B PC1; LOC2C PC2; LOC2D PC3; HOC2A PC4; HOC2B PC5; HOC2C PC6; HOC2D PC7
AWEXC at 0x880 (AWEX)
  pins: OC0ALS PC0; OC0AHS PC1; OC0BLS PC2; OC0BHS PC3; OC0CLS PC4; OC0CHS PC5; OC0DLS PC6; OC0DHS PC7
HIRESC at 0x890 (HIRES)
USARTC0 at 0x8A0 (USART)
  pins: XCK PC1 or PC5/USART_ALT; RXD PC2 or PC6/USART_ALT; TXD PC3 or PC7/USART_ALT
  pin routing set by: USART0
SPIC at 0x8C0 (SPI)
  pins: SS PC4 or PC4/SPI_ALT; MOSI PC5 or PC7/SPI_ALT; MISO PC6 or PC6/SPI_ALT; SCK PC7 or PC5/SPI_ALT
  pin routing set by: SPI
IRCOM at 0x8F8
LCD at 0x0D00
  pins: SEG24 PG0/LCD_SEG; SEG23 PG1/LCD_SEG; SEG22 PG2/LCD_SEG; SEG21 PG3/LCD_SEG; SEG20 PG4/LCD_SEG; SEG19 PG5/LCD_SEG; SEG18 PG6/LCD_SEG; SEG17 PG7/LCD_SEG; SEG16 PM0/LCD_SEG; SEG15 PM1/LCD_SEG; SEG14 PM2/LCD_SEG; SEG13 PM3/LCD_SEG; SEG12 PM4/LCD_SEG; SEG11 PM5/LCD_SEG; SEG10 PM6/LCD_SEG; SEG9 PM7/LCD_SEG; SEG{n} SEG{n}/LCD_SEG (n=0..8); BLINK1 SEG1/LCD_BLINK; BLINK0 SEG0/LCD_BLINK; BIAS1 BIAS1/LCD_BIAS; BIAS2 BIAS2/LCD_BIAS; VLCD VLCD/LCD_BIAS; CAPL CAPL/LCD_BIAS; CAPH CAPH/LCD_BIAS; COM0 COM0/LCD_COM or COM3/LCD_COM_SWP; COM1 COM1/LCD_COM or COM2/LCD_COM_SWP; COM2 COM2/LCD_COM or COM1/LCD_COM_SWP; COM3 COM3/LCD_COM or COM0/LCD_COM_SWP
FUSE at 0x00 in fuses (NVM_FUSES)
LOCKBIT at 0x00 in lockbits (NVM_LOCKBITS)
PROD_SIGNATURES at 0x00 in prod_signatures (NVM_PROD_SIGNATURES)

## Interrupts
1 OSC_OSCF — Oscillator Failure Interrupt (NMI)
2 PORTC_INT0 — External Interrupt 0
3 PORTC_INT1 — External Interrupt 1
4 PORTR_INT0 — External Interrupt 0
5 PORTR_INT1 — External Interrupt 1
6 DMA_CH0 — Channel 0 Interrupt
7 DMA_CH1 — Channel 1 Interrupt
10 RTC_OVF — Overflow Interrupt
11 RTC_COMP — Compare Interrupt
12 TWIC_TWIS — TWI Slave Interrupt
13 TWIC_TWIM — TWI Master Interrupt
14 TCC0_OVF — Overflow Interrupt
15 TCC0_ERR — Error Interrupt
16 TCC0_CCA — Compare or Capture A Interrupt
17 TCC0_CCB — Compare or Capture B Interrupt
18 TCC0_CCC — Compare or Capture C Interrupt
19 TCC0_CCD — Compare or Capture D Interrupt
20 TCC1_OVF — Overflow Interrupt
21 TCC1_ERR — Error Interrupt
22 TCC1_CCA — Compare or Capture A Interrupt
23 TCC1_CCB — Compare or Capture B Interrupt
24 SPIC_INT — SPI Interrupt
25 USARTC0_RXC — Reception Complete Interrupt
26 USARTC0_DRE — Data Register Empty Interrupt
27 USARTC0_TXC — Transmission Complete Interrupt
31 USB_BUSEVENT — SOF, suspend, resume, reset bus event interrupts, crc, underflow, overflow and stall error interrupts
32 USB_TRNCOMPL — Transaction complete interrupt
35 LCD_INT — LCD Interrupt
36 AES_INT — AES Interrupt
37 NVM_EE — EE Interrupt
38 NVM_SPM — SPM Interrupt
39 PORTB_INT0 — External Interrupt 0
40 PORTB_INT1 — External Interrupt 1
41 ACB_AC0 — AC0 Interrupt
42 ACB_AC1 — AC1 Interrupt
43 ACB_ACW — ACW Window Mode Interrupt
44 ADCB_CH0 — Interrupt 0
48 PORTD_INT0 — External Interrupt 0
49 PORTD_INT1 — External Interrupt 1
50 PORTG_INT0 — External Interrupt 0
51 PORTG_INT1 — External Interrupt 1
52 PORTM_INT0 — External Interrupt 0
53 PORTM_INT1 — External Interrupt 1

## Properties
SIGNATURES: JTAGID=0x0974B03F, SIGNATURE0=0x1E, SIGNATURE1=0x97, SIGNATURE2=0x4B

## Pinouts (pin number, pad)
QFP_QFN_64: 1 PC0, 2 PC1, 3 PC2, 4 PC3, 5 PC4, 6 PC5, 7 PC6, 8 PC7, 9 GND, 10 VCC, 11 PD0, 12 PD1, 13 RESET, 14 PDI, 15 GND, 16 VCC, 17 PG0, 18 PG1, 19 PG2, 20 PG3, 21 PG4, 22 PG5, 23 PG6, 24 PG7, 25 PM0, 26 PM1, 27 PM2, 28 PM3, 29 PM4, 30 PM5, 31 PM6, 32 PM7, 33 SEG8, 34 SEG7, 35 SEG6, 36 SEG5, 37 SEG4, 38 SEG3, 39 SEG2, 40 SEG1, 41 SEG0, 42 GND, 43 VCC, 44 BIAS1, 45 BIAS2, 46 VLCD, 47 CAPL, 48 CAPH, 49 COM0, 50 COM1, 51 COM2, 52 COM3, 53 PR0, 54 PR1, 55 AGND, 56 AVCC, 57 PB0, 58 PB1, 59 PB2, 60 PB3, 61 PB4, 62 PB5, 63 PB6, 64 PB7
DRQFN_64: A1 PC0, B1 PC1, A2 PC2, B2 PC3, A3 PC4, B3 PC5, A4 PC6, B4 GND, A5 PC7, B5 PD0, A6 VCC, B6 RESET, A7 PD1, B7 PDI, A8 GND, A9 PG0, B8 VCC, A10 PG2, B9 PG1, A11 PG3, B10 PG4, A12 PG5, B11 PG6, A13 PG7, B12 PM0, A14 PM1, B13 PM2, A15 PM3, B14 PM5, A16 PM4, B15 PM7, A17 PM6, A18 SEG7, B16 SEG8, A19 SEG6, B17 SEG5, A20 SEG4, B18 SEG3, A21 SEG2, B19 SEG1, A22 SEG0, B20 GND, A23 VCC, B21 BIAS1, A24 BIAS2, B22 VLCD, A25 CAPL, A26 CAPH, B23 COM0, A27 COM1, B24 COM2, A28 COM3, B25 PR0, A29 PR1, B26 AGND, A30 PB0, B27 AVCC, A31 PB1, B28 PB2, A32 PB3, B29 PB4, A33 PB5, B30 PB7, A34 PB6
