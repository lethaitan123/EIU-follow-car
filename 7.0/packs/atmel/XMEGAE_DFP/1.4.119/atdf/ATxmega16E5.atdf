# ATxmega16E5 device description
Architecture: AVR8_XMEGA; Family: AVR XMEGA
Programming and debug interfaces: PDI
Registers are 8-bit, access not given, no defined reset value unless marked. A register's access mark holds for its fields unless they carry their own. Offsets are from the block's base; lines under a group give offsets from that group; [hi:lo] are bit positions; {n}, {i} and the like mark numbered series; 'fields as' and 'values as' point back to an identical list; <NAME> marks a mode.

## Ordering variants
ATxmega16E5-AU: TQFP32, pinout QFP_QFN_32, up to 32 MHz, -40 to 85 C, 1.6 to 3.6 V
ATxmega16E5-MU: VQFN32, pinout QFP_QFN_32, up to 32 MHz, -40 to 85 C, 1.6 to 3.6 V
ATxmega16E5-M4U: UQFN32, pinout QFP_QFN_32, up to 32 MHz, -40 to 85 C, 1.6 to 3.6 V
ATxmega16E5-AN: TQFP32, pinout QFP_QFN_32, up to 32 MHz, -40 to 105 C, 1.6 to 3.6 V
ATxmega16E5-MN: VQFN32, pinout QFP_QFN_32, up to 32 MHz, -40 to 105 C, 1.6 to 3.6 V
ATxmega16E5-M4N: UQFN32, pinout QFP_QFN_32, up to 32 MHz, -40 to 105 C, 1.6 to 3.6 V

## Memory
prog space: start 0x00000 size 0x5000, little endian
  0x00000 APP_SECTION size 0x4000 flash, rw, executable, page 128
  0x03000 APPTABLE_SECTION size 0x1000 flash, rw, executable, page 128
  0x04000 BOOT_SECTION size 0x1000 flash, rw, executable, page 128
data space: start 0x0000 size 0x2800, little endian
  0x0000 IO size 0x1000 io, rw
  0x1000 MAPPED_EEPROM size 0x0200 eeprom, rw
  0x2000 INTERNAL_SRAM size 0x0800 ram, rw
eeprom space: start 0x00000 size 0x0200
  0x00000 EEPROM size 0x0200 eeprom, rw, page 32
signatures space: start 0x0000 size 0x0003
  0x0000 SIGNATURES size 0x0003 signatures, ro
fuses space: start 0x0000 size 0x0007
  0x0000 FUSES size 0x0007 fuses, rw
lockbits space: start 0x0000 size 0x0001
  0x0000 LOCKBITS size 0x0001 lockbits, rw
user_signatures space: start 0x0000 size 0x0080
  0x0000 USER_SIGNATURES size 0x0080 user_signatures, rw, page 128
prod_signatures space: start 0x0000 size 0x0036
  0x0000 PROD_SIGNATURES size 0x0036 other, ro, page 128

## Peripheral instances (address, pins/pin function, parameters)
GPIO at 0x0000
VPORT{n} at {0x10+4n} (VPORT) (n=0..3)
OCD at 0x002E
CPU at 0x0030
  parameters: CORE_VERSION=V3XJ
CLK at 0x0040
  pins: EXTCLK PC4/EXTERNAL_CLOCK
PR at 0x0070
SLEEP at 0x0048
OSC at 0x0050
  pins: XTAL2 PR0/XTAL; XTAL1 PR1/XTAL; TOSC2 PR0/TOSC; TOSC1 PR1/TOSC
DFLLRC32M at 0x0060 (DFLL)
RST at 0x0078
WDT at 0x0080
MCU at 0x0090
PMIC at 0x00A0
PORTCFG at 0x00B0
  pins: CLKOUT PD7/CLKOUTD or PD4/CLKOUTD_ALT or PR0/CLKOUTR; EVOUT PD7/EVOUTD or PD4/EVOUTD_ALT or PR0/EVOUTR; RTCOUT PD6/RTCOUTD or PR0/RTCOUTR
  pin routing set by: CLKOUT, CLKEVPIN, EVOUT, RTCOUT
CRC at 0x0D0
EDMA at 0x0100
EVSYS at 0x0180
NVM at 0x01C0
ADCA at 0x0200 (ADC)
  pins: ADC{n} PA{n} (n=0..7); ADC{n} PD{n-8} (n=8..15); REFA0 PA0/AREF; REFD0 PD0/AREF
DACA at 0x0300 (DAC)
  pins: DAC0 PA2; DAC1 PA3; REFA0 PA0/AREF; REFD0 PD0/AREF
ACA at 0x0380 (AC)
  pins: AC{n} PA{n} (n=0..7); ACOUT1 PA6/ACOUT_PA or PC6/ACOUT_PC or PD6/ACOUT_PD or PR0/ACOUT_PR; ACOUT0 PA7/ACOUT_PA or PC7/ACOUT_PC or PD7/ACOUT_PD or PR1/ACOUT_PR
  pin routing set by: ACOUT
RTC at 0x0400
XCL at 0x0460
  pins: IN1 PC0/XCLIN_LSB_PC or PC4/XCLIN_MSB_PC or PD0/XCLIN_LSB_PD or PD4/XCLIN_MSB_PD; IN2 PC1/XCLIN_LSB_PC or PC5/XCLIN_MSB_PC or PD1/XCLIN_LSB_PD or PD5/XCLIN_MSB_PD; IN0 PC2/XCLIN_LSB_PC or PC6/XCLIN_MSB_PC or PD2/XCLIN_LSB_PD or PD6/XCLIN_MSB_PD; IN3 PC3/XCLIN_LSB_PC or PC7/XCLIN_MSB_PC or PD3/XCLIN_LSB_PD or PD7/XCLIN_MSB_PD; OUT0 PC0/XCLOUT_LSB_PC or PC4/XCLOUT_MSB_PC or PD0/XCLOUT_LSB_PD or PD4/XCLOUT_LSB_PD; OC0 PD2/XCL_OCOUT; OC1 PD3/XCL_OCOUT
TWIC at 0x480 (TWI)
  pins: SDA PC0 or PD0/TWI_BRIDGE; SCL PC1 or PD1/TWI_BRIDGE
PORTA at 0x0600 (PORT)
  pins: P{n} PA{n} (n=0..7)
PORTC at 0x0640 (PORT)
  pins: P{n} PC{n} (n=0..7)
PORTD at 0x0660 (PORT)
  pins: P{n} PD{n} (n=0..7)
PORTR at 0x07E0 (PORT)
  pins: P0 PR0; P1 PR1
TCC4 at 0x800 (TC4)
  pins: OC4A PC0/TC4 or PC4/TC4_ALT; OC4B PC1/TC4 or PC5/TC4_ALT; OC4C PC2/TC4 or PC6/TC4_ALT; OC4D PC3/TC4 or PC7/TC4_ALT
  pin routing set by: TC4A, TC4B, TC4C, TC4D
TCC5 at 0x840 (TC5)
  pins: OC5A PC4/TC5; OC5B PC5/TC5
TCD5 at 0x940 (TC5)
  pins: OC5A PD4/TC5; OC5B PD5/TC5
FAULTC4 at 0x880 (FAULT)
FAULTC5 at 0x890 (FAULT)
WEXC at 0x8A0 (WEX)
  pins: OC4ALS PC0; OC4AHS PC1; OC4BLS PC2; OC4BHS PC3; OC4CLS PC4; OC4CHS PC5; OC4DLS PC6; OC4DHS PC7
HIRESC at 0x8B0 (HIRES)
USARTC0 at 0x8C0 (USART)
  pins: XCK PC1 or PC5/USART_ALT; RXD PC2 or PC6/USART_ALT; TXD PC3 or PC7/USART_ALT
  pin routing set by: USART0
USARTD0 at 0x9C0 (USART)
  pins: XCK PD1 or PD5/USART_ALT; RXD PD2 or PD6/USART_ALT; TXD PD3 or PD7/USART_ALT
  pin routing set by: USART0
SPIC at 0x08E0 (SPI)
  pins: SS PC4; SCK PC5; MISO PC6; MOSI PC7
IRCOM at 0x8F8
FUSE at 0x00 in fuses (NVM_FUSES)
LOCKBIT at 0x00 in lockbits (NVM_LOCKBITS)
PROD_SIGNATURES at 0x00 in prod_signatures (NVM_PROD_SIGNATURES)

## Interrupts
1 OSC_OSCF — Oscillator Failure Interrupt (NMI)
2 PORTR_INT — External Interrupt
3 EDMA_CH0 — EDMA Channel 0 Interrupt
4 EDMA_CH1 — EDMA Channel 1 Interrupt
5 EDMA_CH2 — EDMA Channel 2 Interrupt
6 EDMA_CH3 — EDMA Channel 3 Interrupt
7 RTC_OVF — Overflow Interrupt
8 RTC_COMP — Compare Interrupt
9 PORTC_INT — External Interrupt
10 TWIC_TWIS — TWI Slave Interrupt
11 TWIC_TWIM — TWI Master Interrupt
12 TCC4_OVF — Overflow Interrupt
13 TCC4_ERR — Error Interrupt
14 TCC4_CCA — Channel A Compare or Capture Interrupt
15 TCC4_CCB — Channel B Compare or Capture Interrupt
16 TCC4_CCC — Channel C Compare or Capture Interrupt
17 TCC4_CCD — Channel D Compare or Capture Interrupt
18 TCC5_OVF — Overflow Interrupt
19 TCC5_ERR — Error Interrupt
20 TCC5_CCA — Channel A Compare or Capture Interrupt
21 TCC5_CCB — Channel B Compare or Capture Interrupt
22 SPIC_INT — SPI Interrupt
23 USARTC0_RXC — Reception Complete Interrupt
24 USARTC0_DRE — Data Register Empty Interrupt
25 USARTC0_TXC — Transmission Complete Interrupt
26 NVM_EE — EE Interrupt
27 NVM_SPM — SPM Interrupt
28 XCL_UNF — Timer/Counter Underflow Interrupt
29 XCL_CC — Timer/Counter Compare or Capture Interrupt
30 PORTA_INT — External Interrupt
31 ACA_AC0 — AC0 Interrupt
32 ACA_AC1 — AC1 Interrupt
33 ACA_ACW — ACW Window Mode Interrupt
34 ADCA_CH0 — ADC Channel Interrupt
35 PORTD_INT — External Interrupt
36 TCD5_OVF — Overflow Interrupt
37 TCD5_ERR — Error Interrupt
38 TCD5_CCA — Channel A Compare or Capture Interrupt
39 TCD5_CCB — Channel B Compare or Capture Interrupt
40 USARTD0_RXC — Reception Complete Interrupt
41 USARTD0_DRE — Data Register Empty Interrupt
42 USARTD0_TXC — Transmission Complete Interrupt

## Properties
SIGNATURES: SIGNATURE0=0x1E, SIGNATURE1=0x94, SIGNATURE2=0x45

## Pinouts (pin number, pad)
QFP_QFN_32: 1 GND, 2 PA4, 3 PA3, 4 PA2, 5 PA1, 6 PA0, 7 PDI, 8 RESET, 9 PC7, 10 PC6, 11 PC5, 12 PC4, 13 PC3, 14 PC2, 15 PC1, 16 PC0, 17 VCC, 18 GND, 19 PR1, 20 PR0, 21 PD7, 22 PD6, 23 PD5, 24 PD4, 25 PD3, 26 PD2, 27 PD1, 28 PD0, 29 PA7, 30 PA6, 31 PA5, 32 AVCC
