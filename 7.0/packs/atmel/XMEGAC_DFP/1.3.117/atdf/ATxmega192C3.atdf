# ATxmega192C3 device description
Architecture: AVR8_XMEGA; Family: AVR XMEGA
Programming and debug interfaces: PDI
Registers are 8-bit, access not given, no defined reset value unless marked. A register's access mark holds for its fields unless they carry their own. Offsets are from the block's base; lines under a group give offsets from that group; [hi:lo] are bit positions; {n}, {i} and the like mark numbered series; 'fields as' and 'values as' point back to an identical list; <NAME> marks a mode.

## Ordering variants
ATXMEGA192C3-AU: TQFP64, up to 32 MHz, 1.6 to 3.6 V
ATXMEGA192C3-MH: QFN64, up to 32 MHz, 1.6 to 3.6 V

## Memory
prog space: start 0x00000 size 0x32000, little endian
  0x00000 APP_SECTION size 0x30000 flash, rw, executable, page 512
  0x2E000 APPTABLE_SECTION size 0x2000 flash, rw, executable, page 512
  0x30000 BOOT_SECTION size 0x2000 flash, rw, executable, page 512
data space: start 0x0000 size 0x4000, little endian
  0x0000 IO size 0x1000 io, rw
  0x1000 MAPPED_EEPROM size 0x0800 eeprom, rw
  0x2000 INTERNAL_SRAM size 0x4000 ram, rw
eeprom space: start 0x00000 size 0x0800
  0x00000 EEPROM size 0x0800 eeprom, rw, page 32
signatures space: start 0x0000 size 0x0003
  0x0000 SIGNATURES size 0x0003 signatures, ro
fuses space: start 0x0000 size 0x0006
  0x0000 FUSES size 0x0006 fuses, rw
lockbits space: start 0x0000 size 0x0001
  0x0000 LOCKBITS size 0x0001 lockbits, rw
user_signatures space: start 0x0000 size 0x0200
  0x0000 USER_SIGNATURES size 0x0200 user_signatures, rw, page 512
prod_signatures space: start 0x0000 size 0x0040
  0x0000 PROD_SIGNATURES size 0x0040 other, ro, page 512

## Peripheral instances (address, pins/pin function, parameters)
GPIO at 0x0000
VPORT{n} at {0x10+4n} (VPORT) (n=0..3)
OCD at 0x002E
CPU at 0x0030
  parameters: CORE_VERSION=V3XJ
CLK at 0x0040
PR at 0x0070
SLEEP at 0x0048
OSC at 0x0050
DFLLRC32M at 0x0060 (DFLL)
DFLLRC2M at 0x0068 (DFLL)
RST at 0x0078
WDT at 0x0080
MCU at 0x0090
PMIC at 0x00A0
PORTCFG at 0x00B0
CRC at 0x0D0
EVSYS at 0x0180
NVM at 0x01C0
ADCA at 0x0200 (ADC)
ACA at 0x0380 (AC)
RTC at 0x0400
TWIC at 0x480 (TWI)
TWIE at 0x4A0 (TWI)
USB at 0x4C0
PORTA at 0x0600 (PORT)
PORTB at 0x0620 (PORT)
PORTC at 0x0640 (PORT)
PORTD at 0x0660 (PORT)
PORTE at 0x0680 (PORT)
PORTF at 0x06A0 (PORT)
PORTR at 0x07E0 (PORT)
TCC0 at 0x800 (TC0)
TCC1 at 0x840 (TC1)
TCD0 at 0x900 (TC0)
TCE0 at 0xA00 (TC0)
TCF0 at 0xB00 (TC0)
TCC2 at 0x800 (TC2)
TCD2 at 0x900 (TC2)
TCE2 at 0xA00 (TC2)
TCF2 at 0xB00 (TC2)
AWEXC at 0x880 (AWEX)
HIRESC at 0x890 (HIRES)
USARTC0 at 0x8A0 (USART)
USARTD0 at 0x9A0 (USART)
USARTE0 at 0xAA0 (USART)
SPIC at 0x8C0 (SPI)
SPID at 0x9C0 (SPI)
IRCOM at 0x8F8
FUSE at 0x00 in fuses (NVM_FUSES)
LOCKBIT at 0x00 in lockbits (NVM_LOCKBITS)
PROD_SIGNATURES at 0x00 in prod_signatures (NVM_PROD_SIGNATURES)

## Interrupts
1 OSC_OSCF — Oscillator Failure Interrupt (NMI)
2 PORTC_INT0 — External Interrupt 0
3 PORTC_INT1 — External Interrupt 1
4 PORTR_INT0 — External Interrupt 0
5 PORTR_INT1 — External Interrupt 1
10 RTC_OVF — Overflow Interrupt
11 RTC_COMP — Compare Interrupt
12 TWIC_TWIS — TWI Slave Interrupt
13 TWIC_TWIM — TWI Master Interrupt
14 TCC0_OVF — Overflow Interrupt
15 TCC0_ERR — Error Interrupt
16 TCC0_CCA — Compare or Capture A Interrupt
17 TCC0_CCB — Compare or Capture B Interrupt
18 TCC0_CCC — Compare or Capture C Interrupt
19 TCC0_CCD — Compare or Capture D Interrupt
20 TCC1_OVF — Overflow Interrupt
21 TCC1_ERR — Error Interrupt
22 TCC1_CCA — Compare or Capture A Interrupt
23 TCC1_CCB — Compare or Capture B Interrupt
24 SPIC_INT — SPI Interrupt
25 USARTC0_RXC — Reception Complete Interrupt
26 USARTC0_DRE — Data Register Empty Interrupt
27 USARTC0_TXC — Transmission Complete Interrupt
32 NVM_EE — EE Interrupt
33 NVM_SPM — SPM Interrupt
34 PORTB_INT0 — External Interrupt 0
35 PORTB_INT1 — External Interrupt 1
43 PORTE_INT0 — External Interrupt 0
44 PORTE_INT1 — External Interrupt 1
45 TWIE_TWIS — TWI Slave Interrupt
46 TWIE_TWIM — TWI Master Interrupt
47 TCE0_OVF — Overflow Interrupt
48 TCE0_ERR — Error Interrupt
49 TCE0_CCA — Compare or Capture A Interrupt
50 TCE0_CCB — Compare or Capture B Interrupt
51 TCE0_CCC — Compare or Capture C Interrupt
52 TCE0_CCD — Compare or Capture D Interrupt
58 USARTE0_RXC — Reception Complete Interrupt
59 USARTE0_DRE — Data Register Empty Interrupt
60 USARTE0_TXC — Transmission Complete Interrupt
64 PORTD_INT0 — External Interrupt 0
65 PORTD_INT1 — External Interrupt 1
66 PORTA_INT0 — External Interrupt 0
67 PORTA_INT1 — External Interrupt 1
68 ACA_AC0 — AC0 Interrupt
69 ACA_AC1 — AC1 Interrupt
70 ACA_ACW — ACW Window Mode Interrupt
71 ADCA_CH0 — Interrupt 0
77 TCD0_OVF — Overflow Interrupt
78 TCD0_ERR — Error Interrupt
79 TCD0_CCA — Compare or Capture A Interrupt
80 TCD0_CCB — Compare or Capture B Interrupt
81 TCD0_CCC — Compare or Capture C Interrupt
82 TCD0_CCD — Compare or Capture D Interrupt
87 SPID_INT — SPI Interrupt
88 USARTD0_RXC — Reception Complete Interrupt
89 USARTD0_DRE — Data Register Empty Interrupt
90 USARTD0_TXC — Transmission Complete Interrupt
104 PORTF_INT0 — External Interrupt 0
105 PORTF_INT1 — External Interrupt 1
108 TCF0_OVF — Overflow Interrupt
109 TCF0_ERR — Error Interrupt
110 TCF0_CCA — Compare or Capture A Interrupt
111 TCF0_CCB — Compare or Capture B Interrupt
112 TCF0_CCC — Compare or Capture C Interrupt
113 TCF0_CCD — Compare or Capture D Interrupt
125 USB_BUSEVENT — SOF, suspend, resume, reset bus event interrupts, crc, underflow, overflow and stall error interrupts
126 USB_TRNCOMPL — Transaction complete interrupt

## Properties
SIGNATURES: SIGNATURE0=0x1E, SIGNATURE1=0x97, SIGNATURE2=0x51
