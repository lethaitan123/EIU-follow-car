# ATxmega32A4 device description
Architecture: AVR8_XMEGA; Family: AVR XMEGA
Programming and debug interfaces: PDI
Registers are 8-bit, access not given, no defined reset value unless marked. A register's access mark holds for its fields unless they carry their own. Offsets are from the block's base; lines under a group give offsets from that group; [hi:lo] are bit positions; {n}, {i} and the like mark numbered series; 'fields as' and 'values as' point back to an identical list; <NAME> marks a mode.

## Ordering variants
ATXMEGA32A4-AU: TQFP44, pinout QFN_QFP_44, up to 32 MHz, 1.6 to 3.6 V
ATXMEGA32A4-MU: VQFN44, pinout QFN_QFP_44, up to 32 MHz, 1.6 to 3.6 V

## Memory
prog space: start 0x0000 size 0x9000, little endian
  0x0000 APP_SECTION size 0x8000 flash, rw, executable, page 256
  0x07000 APPTABLE_SECTION size 0x1000 flash, rw, executable, page 256
  0x8000 BOOT_SECTION size 0x1000 flash, rw, executable, page 256
data space: start 0x0000 size 0x3000, little endian
  0x0000 IO size 0x1000 io, rw
  0x1000 MAPPED_EEPROM size 0x0400 eeprom, rw
  0x2000 INTERNAL_SRAM size 0x1000 ram, rw
eeprom space: start 0x0000 size 0x0400
  0x0000 EEPROM size 0x0400 eeprom, rw, page 32
signatures space: start 0x0000 size 0x0003
  0x0000 SIGNATURES size 0x0003 signatures, ro
fuses space: start 0x0000 size 0x0006
  0x0000 FUSES size 0x0006 fuses, rw
lockbits space: start 0x0000 size 0x0001
  0x0000 LOCKBITS size 0x0001 lockbits, rw
user_signatures space: start 0x0000 size 0x0100
  0x0000 USER_SIGNATURES size 0x0100 user_signatures, rw, page 256
prod_signatures space: start 0x0000 size 0x0034
  0x0000 PROD_SIGNATURES size 0x0034 other, ro, page 256

## Peripheral instances (address, pins/pin function, parameters)
GPIO at 0x0000
OCD at 0x002E
CPU at 0x0030
  parameters: CORE_VERSION=V3X
CLK at 0x0040
PR at 0x0070
SLEEP at 0x0048
OSC at 0x0050
DFLLRC32M at 0x0060 (DFLL)
DFLLRC2M at 0x0068 (DFLL)
RST at 0x0078
WDT at 0x0080
MCU at 0x0090
PMIC at 0x00A0
DMA at 0x0100
EVSYS at 0x0180
NVM at 0x01C0
FUSE at 0x00 in fuses (NVM_FUSES)
LOCKBIT at 0x00 in lockbits (NVM_LOCKBITS)
PROD_SIGNATURES at 0x00 in prod_signatures (NVM_PROD_SIGNATURES)
ACA at 0x0380 (AC)
ADCA at 0x0200 (ADC)
DACB at 0x0320 (DAC)
RTC at 0x0400
TWIC at 0x480 (TWI)
TWIE at 0x4A0 (TWI)
PORT_CFG at PORTCFG 0x00B0
VPORT{n} at {0x10+4n} (VPORT) (n=0..3)
PORTA at 0x0600 (PORT)
PORTB at 0x0620 (PORT)
PORTC at 0x0640 (PORT)
PORTD at 0x0660 (PORT)
PORTE at 0x0680 (PORT)
PORTR at 0x07E0 (PORT)
TCC0 at 0x800 (TC0)
TCC1 at 0x840 (TC1)
AWEXC at 0x880 (AWEX)
HIRESC at 0x890 (HIRES)
TCD0 at 0x900 (TC0)
TCD1 at 0x940 (TC1)
HIRESD at 0x990 (HIRES)
TCE0 at 0xA00 (TC0)
HIRESE at 0xA90 (HIRES)
USARTC0 at 0x8A0 (USART)
USARTC1 at 0x8B0 (USART)
USARTD0 at 0x9A0 (USART)
USARTD1 at 0x9B0 (USART)
USARTE0 at 0xAA0 (USART)
SPIC at 0x8C0 (SPI)
SPID at 0x9C0 (SPI)
IRCOM at 0x8F8
AES at 0x0C0

## Interrupts
1 OSC_OSCF — External Oscillator Failure Interrupt (NMI)
2 PORTC_INT0 — External Interrupt 0
3 PORTC_INT1 — External Interrupt 1
4 PORTR_INT0 — External Interrupt 0
5 PORTR_INT1 — External Interrupt 1
6 DMA_CH0 — Channel 0 Interrupt
7 DMA_CH1 — Channel 1 Interrupt
8 DMA_CH2 — Channel 2 Interrupt
9 DMA_CH3 — Channel 3 Interrupt
10 RTC_OVF — Overflow Interrupt
11 RTC_COMP — Compare Interrupt
12 TWIC_TWIS — TWI Slave Interrupt
13 TWIC_TWIM — TWI Master Interrupt
14 TCC0_OVF — Overflow Interrupt
15 TCC0_ERR — Error Interrupt
16 TCC0_CCA — Compare or Capture A Interrupt
17 TCC0_CCB — Compare or Capture B Interrupt
18 TCC0_CCC — Compare or Capture C Interrupt
19 TCC0_CCD — Compare or Capture D Interrupt
20 TCC1_OVF — Overflow Interrupt
21 TCC1_ERR — Error Interrupt
22 TCC1_CCA — Compare or Capture A Interrupt
23 TCC1_CCB — Compare or Capture B Interrupt
24 SPIC_INT — SPI Interrupt
25 USARTC0_RXC — Reception Complete Interrupt
26 USARTC0_DRE — Data Register Empty Interrupt
27 USARTC0_TXC — Transmission Complete Interrupt
28 USARTC1_RXC — Reception Complete Interrupt
29 USARTC1_DRE — Data Register Empty Interrupt
30 USARTC1_TXC — Transmission Complete Interrupt
31 AES_INT — AES Interrupt
32 NVM_EE — EE Interrupt
33 NVM_SPM — SPM Interrupt
34 PORTB_INT0 — External Interrupt 0
35 PORTB_INT1 — External Interrupt 1
43 PORTE_INT0 — External Interrupt 0
44 PORTE_INT1 — External Interrupt 1
45 TWIE_TWIS — TWI Slave Interrupt
46 TWIE_TWIM — TWI Master Interrupt
47 TCE0_OVF — Overflow Interrupt
48 TCE0_ERR — Error Interrupt
49 TCE0_CCA — Compare or Capture A Interrupt
50 TCE0_CCB — Compare or Capture B Interrupt
51 TCE0_CCC — Compare or Capture C Interrupt
52 TCE0_CCD — Compare or Capture D Interrupt
58 USARTE0_RXC — Reception Complete Interrupt
59 USARTE0_DRE — Data Register Empty Interrupt
60 USARTE0_TXC — Transmission Complete Interrupt
64 PORTD_INT0 — External Interrupt 0
65 PORTD_INT1 — External Interrupt 1
66 PORTA_INT0 — External Interrupt 0
67 PORTA_INT1 — External Interrupt 1
68 ACA_AC0 — AC0 Interrupt
69 ACA_AC1 — AC1 Interrupt
70 ACA_ACW — ACW Window Mode Interrupt
71 ADCA_CH0 — Interrupt 0
72 ADCA_CH1 — Interrupt 1
73 ADCA_CH2 — Interrupt 2
74 ADCA_CH3 — Interrupt 3
77 TCD0_OVF — Overflow Interrupt
78 TCD0_ERR — Error Interrupt
79 TCD0_CCA — Compare or Capture A Interrupt
80 TCD0_CCB — Compare or Capture B Interrupt
81 TCD0_CCC — Compare or Capture C Interrupt
82 TCD0_CCD — Compare or Capture D Interrupt
83 TCD1_OVF — Overflow Interrupt
84 TCD1_ERR — Error Interrupt
85 TCD1_CCA — Compare or Capture A Interrupt
86 TCD1_CCB — Compare or Capture B Interrupt
87 SPID_INT — SPI Interrupt
88 USARTD0_RXC — Reception Complete Interrupt
89 USARTD0_DRE — Data Register Empty Interrupt
90 USARTD0_TXC — Transmission Complete Interrupt
91 USARTD1_RXC — Reception Complete Interrupt
92 USARTD1_DRE — Data Register Empty Interrupt
93 USARTD1_TXC — Transmission Complete Interrupt

## Properties
SIGNATURES: JTAGID=0x0954103F, SIGNATURE0=0x1E, SIGNATURE1=0x95, SIGNATURE2=0x41

## Pinouts (pin number, pad)
QFN_QFP_44: 1 PA5, 2 PA6, 3 PA7, 4 PB0, 5 PB1, 6 PB2, 7 PB3, 8 GND, 9 VCC, 10 PC0, 11 PC1, 12 PC2, 13 PC3, 14 PC4, 15 PC5, 16 PC6, 17 PC7, 18 GND, 19 VCC, 20 PD0, 21 PD1, 22 PD2, 23 PD3, 24 PD4, 25 PD5, 26 PD6, 27 PD7, 28 PE0, 29 PE1, 30 GND, 31 VCC, 32 PE2, 33 PE3, 34 PDI, 35 RESET, 36 PR0, 37 PR1, 38 GND, 39 AVCC, 40 PA0, 41 PA1, 42 PA2, 43 PA3, 44 PA4
