# AVR128DA64 device description
Architecture: AVR8X; Family: AVR
Programming and debug interfaces: UPDI
Registers are 8-bit, read-write, reset 0x0 unless marked. A register's access mark holds for its fields unless they carry their own. Offsets are from the block's base; lines under a group give offsets from that group; [hi:lo] are bit positions; {n}, {i} and the like mark numbered series; 'fields as' and 'values as' point back to an identical list; <NAME> marks a mode.

## Ordering variants
AVR128DA64: QFN64, up to 24 MHz, -40 to 125 C, 1.8 to 5.5 V

## Memory
data space: start 0x0000 size 0x10000, little endian
  0x00001400 EEPROM size 0x0200 eeprom, rw, page 0x1
  0x00001050 FUSES size 0x10 fuses, rw, page 0x1
  0x4000 INTERNAL_SRAM size 0x4000 ram, rw
  0x00000000 IO size 0x103F io, rw
  0x00001040 LOCKBITS size 0x4 lockbits, rw, page 0x1
  0x00008000 MAPPED_PROGMEM size 0x8000 other, rw, page 0x200
  0x00001103 PROD_SIGNATURES size 0x7D signatures, ro, page 0x80
  0x00001100 SIGNATURES size 0x3 signatures, ro, page 0x80
  0x00001080 USER_SIGNATURES size 0x20 user_signatures, rw, page 0x20
prog space: start 0x0000 size 0x20000, little endian
  0x00000000 PROGMEM size 0x20000 flash, rw, executable, page 0x200

## Peripheral instances (address, pins/pin function, parameters)
AC0 at 0x0680 (AC)
  pins: N0 PD3; N1 PD0; N2 PD7; OUT0 PC6/AC0_ALT or PA7; P0 PD2; P1 PE0; P2 PE2; P3 PD6
  pin routing set by: PORTMUX.ACROUTEA.AC0
AC1 at 0x0688 (AC)
  pins: N0 PD5; N1 PD0; N2 PD7; OUT0 PC6/AC1_ALT or PA7; P0 PD2; P1 PD3; P2 PD4; P3 PD6
  pin routing set by: PORTMUX.ACROUTEA.AC1
AC2 at 0x0690 (AC)
  pins: N0 PD7; N1 PD0; N2 PD7; OUT0 PC6/AC2_ALT or PA7; P0 PD2; P1 PD4; P2 PE1; P3 PD6
  pin routing set by: PORTMUX.ACROUTEA.AC2
ADC0 at 0x0600 (ADC)
  pins: AIN{n} PD{n}/AIN0 (n=0..7); AIN{n} PE{n-8}/AIN0 (n=8..15); AIN16 PF0/AIN0; AIN17 PF1/AIN0; AIN18 PF2/AIN0; AIN19 PF3/AIN0; AIN20 PF4/AIN0; AIN21 PF5/AIN0
BOD at 0x0080
CCL at 0x01C0
  pins: LUT0_IN0 PA0/CCL_IN; LUT0_IN1 PA1/CCL_IN; LUT0_IN2 PA2/CCL_IN; LUT0_OUT0 PA6/CCL_ALT or PA3; LUT1_IN0 PC0/CCL_IN; LUT1_IN1 PC1/CCL_IN; LUT1_IN2 PC2/CCL_IN; LUT1_OUT0 PC6/CCL_ALT or PC3; LUT2_IN0 PD0/CCL_IN; LUT2_IN1 PD1/CCL_IN; LUT2_IN2 PD2/CCL_IN; LUT2_OUT0 PD6/CCL_ALT or PD3; LUT3_IN0 PF0/CCL_IN; LUT3_IN1 PF1/CCL_IN; LUT3_IN2 PF2/CCL_IN; LUT3_OUT0 PF3; LUT4_IN0 PB0/CCL_IN; LUT4_IN1 PB1/CCL_IN; LUT4_IN2 PB2/CCL_IN; LUT4_OUT0 PB6/CCL_ALT or PB3; LUT5_IN0 PG0/CCL_IN; LUT5_IN1 PG1/CCL_IN; LUT5_IN2 PG2/CCL_IN; LUT5_OUT0 PG6/CCL_ALT or PG3
  pin routing set by: PORTMUX.CCLROUTEA.LUT0, PORTMUX.CCLROUTEA.LUT1, PORTMUX.CCLROUTEA.LUT2, PORTMUX.CCLROUTEA.LUT3, PORTMUX.CCLROUTEA.LUT4, PORTMUX.CCLROUTEA.LUT5
CLKCTRL at 0x0060
  pins: CLKOUT PA7; EXTCLK PA0; XTAL32K1 PF0; XTAL32K2 PF1
CPU at 0x0030
  parameters: CORE_VERSION=V4S
CPUINT at 0x0110
CRCSCAN at 0x0120
DAC0 at 0x06A0 (DAC)
  pins: OUT0 PD6
EVSYS at 0x0200
  pins: EVOUT0 PA7/EVSYS_ALT or PA2; EVOUT1 PB7/EVSYS_ALT or PB2; EVOUT2 PC7/EVSYS_ALT or PC2; EVOUT3 PD7/EVSYS_ALT or PD2; EVOUT4 PE7/EVSYS_ALT or PE2; EVOUT5 PF2; EVOUT6 PG7/EVSYS_ALT or PG2
  pin routing set by: PORTMUX.EVSYSROUTEA.EVOUTA, PORTMUX.EVSYSROUTEA.EVOUTB, PORTMUX.EVSYSROUTEA.EVOUTC, PORTMUX.EVSYSROUTEA.EVOUTD, PORTMUX.EVSYSROUTEA.EVOUTE, PORTMUX.EVSYSROUTEA.EVOUTF, PORTMUX.EVSYSROUTEA.EVOUTG
FUSE at 0x1050
GPR at 0x001C
LOCK at 0x1040
NVMCTRL at 0x1000
PORTA at 0x0400 (PORT)
  pins: PIN{n} PA{n}/IOPORT (n=0..7)
PORTB at 0x0420 (PORT)
  pins: PIN{n} PB{n}/IOPORT (n=0..7)
PORTC at 0x0440 (PORT)
  pins: PIN{n} PC{n}/IOPORT (n=0..7)
PORTD at 0x0460 (PORT)
  pins: PIN{n} PD{n}/IOPORT (n=0..7)
PORTE at 0x0480 (PORT)
  pins: PIN{n} PE{n}/IOPORT (n=0..7)
PORTF at 0x04A0 (PORT)
  pins: PIN0 PF0/IOPORT; PIN1 PF1/IOPORT; PIN2 PF2/IOPORT; PIN3 PF3/IOPORT; PIN4 PF4/IOPORT; PIN5 PF5/IOPORT; PIN6 PF6/IOPORT
PORTG at 0x04C0 (PORT)
  pins: PIN{n} PG{n}/IOPORT (n=0..7)
PORTMUX at 0x05E0
PTC
  pins: XY{n} PA{n} (n=0..7); XY{n} PB{n-8} (n=8..15); XY{n} PD{n-16} (n=16..23); XY{n} PE{n-24} (n=24..31); XY32 PF0; XY33 PF1; XY34 PF2; XY35 PF3; XY36 PF4; XY37 PF5; XY{n} PG{n-40} (n=40..47)
RSTCTRL at 0x0040
  pins: RESET PF6/OTHER
RTC at 0x0140
SIGROW at 0x1100
SLPCTRL at 0x0050
SPI0 at 0x0940 (SPI)
  pins: MISO PG5/SPI0_ALT2 or PE1/SPI0_ALT or PA5; MOSI PG4/SPI0_ALT2 or PE0/SPI0_ALT or PA4; SCK PG6/SPI0_ALT2 or PE2/SPI0_ALT or PA6; SS PG7/SPI0_ALT2 or PE3/SPI0_ALT or PA7
  pin routing set by: PORTMUX.SPIROUTEA.SPI0
SPI1 at 0x0960 (SPI)
  pins: MISO PB5/SPI1_ALT2 or PC5/SPI1_ALT or PC1; MOSI PB4/SPI1_ALT2 or PC4/SPI1_ALT or PC0; SCK PB6/SPI1_ALT2 or PC6/SPI1_ALT or PC2; SS PB7/SPI1_ALT2 or PC7/SPI1_ALT or PC3
  pin routing set by: PORTMUX.SPIROUTEA.SPI1
SYSCFG at 0x0F00
TCA0 at 0x0A00 (TCA)
  pins: WO0 PG0/TCA0_ALT6 or PF0/TCA0_ALT5 or PE0/TCA0_ALT4 or PD0/TCA0_ALT3 or PC0/TCA0_ALT2 or PB0/TCA0_ALT or PA0; WO1 PG1/TCA0_ALT6 or PF1/TCA0_ALT5 or PE1/TCA0_ALT4 or PD1/TCA0_ALT3 or PC1/TCA0_ALT2 or PB1/TCA0_ALT or PA1; WO2 PG2/TCA0_ALT6 or PF2/TCA0_ALT5 or PE2/TCA0_ALT4 or PD2/TCA0_ALT3 or PC2/TCA0_ALT2 or PB2/TCA0_ALT or PA2; WO3 PG3/TCA0_ALT6 or PF3/TCA0_ALT5 or PE3/TCA0_ALT4 or PD3/TCA0_ALT3 or PC3/TCA0_ALT2 or PB3/TCA0_ALT or PA3; WO4 PG4/TCA0_ALT6 or PF4/TCA0_ALT5 or PE4/TCA0_ALT4 or PD4/TCA0_ALT3 or PC4/TCA0_ALT2 or PB4/TCA0_ALT or PA4; WO5 PG5/TCA0_ALT6 or PF5/TCA0_ALT5 or PE5/TCA0_ALT4 or PD5/TCA0_ALT3 or PC5/TCA0_ALT2 or PB5/TCA0_ALT or PA5
  pin routing set by: PORTMUX.TCAROUTEA.TCA0
TCA1 at 0x0A40 (TCA)
  pins: WO0 PG0/TCA1_ALT3 or PE4/TCA1_ALT2 or PC4/TCA1_ALT or PB0; WO1 PG1/TCA1_ALT3 or PE5/TCA1_ALT2 or PC5/TCA1_ALT or PB1; WO2 PG2/TCA1_ALT3 or PE6/TCA1_ALT2 or PC6/TCA1_ALT or PB2; WO3 PG3/TCA1_ALT3 or PB3; WO4 PG4/TCA1_ALT3 or PB4; WO5 PG5/TCA1_ALT3 or PB5
  pin routing set by: PORTMUX.TCAROUTEA.TCA1
TCB0 at 0x0B00 (TCB)
  pins: WO0 PF4/TCB0_ALT or PA2
  pin routing set by: PORTMUX.TCBROUTEA.TCB0
TCB1 at 0x0B10 (TCB)
  pins: WO0 PF5/TCB1_ALT or PA3
  pin routing set by: PORTMUX.TCBROUTEA.TCB1
TCB2 at 0x0B20 (TCB)
  pins: WO0 PB4/TCB2_ALT or PC0
  pin routing set by: PORTMUX.TCBROUTEA.TCB2
TCB3 at 0x0B30 (TCB)
  pins: WO0 PC1/TCB3_ALT or PB5
  pin routing set by: PORTMUX.TCBROUTEA.TCB3
TCB4 at 0x0B40 (TCB)
  pins: WO0 PC6/TCB4_ALT or PG3
  pin routing set by: PORTMUX.TCBROUTEA.TCB4
TCD0 at 0x0B80 (TCD)
  pins: WOA PG4/TCD0_ALT3 or PF0/TCD0_ALT2 or PB4/TCD0_ALT or PA4; WOB1 PG5/TCD0_ALT3 or PF1/TCD0_ALT2 or PB5/TCD0_ALT or PA5; WOC2 PG6/TCD0_ALT3 or PF2/TCD0_ALT2 or PB6/TCD0_ALT or PA6; WOD3 PG7/TCD0_ALT3 or PF3/TCD0_ALT2 or PB7/TCD0_ALT or PA7
  pin routing set by: PORTMUX.TCDROUTEA.TCD0
TWI0 at 0x0900 (TWI)
  pins: SCL PC3/I2C0_ALT2 or PA3/I2C0_ALT1 or PA3/I2C0; SCL_DUAL PC7/I2C0_ALT2 or PC7/I2C0_ALT1 or PC3/I2C0; SDA PC2/I2C0_ALT2 or PA2/I2C0_ALT1 or PA2/I2C0; SDA_DUAL PC6/I2C0_ALT2 or PC6/I2C0_ALT1 or PC2/I2C0
  pin routing set by: PORTMUX.TWIROUTEA.TWI0
TWI1 at 0x0920 (TWI)
  pins: SCL PB3/I2C1_ALT2 or PF3/I2C1_ALT1 or PF3/I2C1; SCL_DUAL PB7/I2C1_ALT2 or PB7/I2C1_ALT1 or PB3/I2C1; SDA PB2/I2C1_ALT2 or PF2/I2C1_ALT1 or PF2/I2C1; SDA_DUAL PB6/I2C1_ALT2 or PB6/I2C1_ALT1 or PB2/I2C1
  pin routing set by: PORTMUX.TWIROUTEA.TWI1
USART0 at 0x0800 (USART)
  pins: RXD PA5/USART0_ALT or PA1; TXD PA4/USART0_ALT or PA0; XCK PA6/USART0_ALT or PA2; XDIR PA7/USART0_ALT or PA3
  pin routing set by: PORTMUX.USARTROUTEA.USART0
USART1 at 0x0820 (USART)
  pins: RXD PC5/USART1_ALT or PC1; TXD PC4/USART1_ALT or PC0; XCK PC6/USART1_ALT or PC2; XDIR PC7/USART1_ALT or PC3
  pin routing set by: PORTMUX.USARTROUTEA.USART1
USART2 at 0x0840 (USART)
  pins: RXD PF5/USART2_ALT or PF1; TXD PF4/USART2_ALT or PF0; XCK PF2; XDIR PF3
  pin routing set by: PORTMUX.USARTROUTEA.USART2
USART3 at 0x0860 (USART)
  pins: RXD PB5/USART3_ALT or PB1; TXD PB4/USART3_ALT or PB0; XCK PB6/USART3_ALT or PB2; XDIR PB7/USART3_ALT or PB3
  pin routing set by: PORTMUX.USARTROUTEA.USART3
USART4 at 0x0880 (USART)
  pins: RXD PE5/USART4_ALT or PE1; TXD PE4/USART4_ALT or PE0; XCK PE6/USART4_ALT or PE2; XDIR PE7/USART4_ALT or PE3
  pin routing set by: PORTMUX.USARTROUTEB.USART4
USART5 at 0x08A0 (USART)
  pins: RXD PG5/USART5_ALT or PG1; TXD PG4/USART5_ALT or PG0; XCK PG6/USART5_ALT or PG2; XDIR PG7/USART5_ALT or PG3
  pin routing set by: PORTMUX.USARTROUTEB.USART5
USERROW at 0x1080
VPORTA at 0x0000 (VPORT)
VPORTB at 0x0004 (VPORT)
VPORTC at 0x0008 (VPORT)
VPORTD at 0x000C (VPORT)
VPORTE at 0x0010 (VPORT)
VPORTF at 0x0014 (VPORT)
VPORTG at 0x0018 (VPORT)
VREF at 0x00A0
WDT at 0x0100
ZCD0 at 0x06C0 (ZCD)
  pins: IN PD1; OUT PC7/ZCD0_ALT or PA7
  pin routing set by: PORTMUX.ZCDROUTEA.ZCD0
ZCD1 at 0x06C8 (ZCD)
  pins: IN PE3; OUT PC7/ZCD1_ALT or PA7
  pin routing set by: PORTMUX.ZCDROUTEA.ZCD1
ZCD2 at 0x06D0 (ZCD)
  pins: IN PE7; OUT PC7/ZCD2_ALT or PA7
  pin routing set by: PORTMUX.ZCDROUTEA.ZCD2

## Interrupts
1 NMI (CRCSCAN)
2 VLM (BOD)
3 CNT (RTC)
4 PIT (RTC)
5 CCL
6 PORT (PORTA)
7 LUNF (TCA0)
7 OVF (TCA0)
8 HUNF (TCA0)
9 CMP0 (TCA0)
9 LCMP0 (TCA0)
10 CMP1 (TCA0)
10 LCMP1 (TCA0)
11 CMP2 (TCA0)
11 LCMP2 (TCA0)
12 INT (TCB0)
13 INT (TCB1)
14 OVF (TCD0)
15 TRIG (TCD0)
16 TWIS (TWI0)
17 TWIM (TWI0)
18 INT (SPI0)
19 RXC (USART0)
20 DRE (USART0)
21 TXC (USART0)
22 PORT (PORTD)
23 AC (AC0)
24 RESRDY (ADC0)
25 WCMP (ADC0)
26 ZCD (ZCD0)
27 PTC
28 AC (AC1)
29 PORT (PORTC)
30 INT (TCB2)
31 RXC (USART1)
32 DRE (USART1)
33 TXC (USART1)
34 PORT (PORTF)
35 EE (NVMCTRL)
36 INT (SPI1)
37 RXC (USART2)
38 DRE (USART2)
39 TXC (USART2)
40 AC (AC2)
41 INT (TCB3)
42 TWIS (TWI1)
43 TWIM (TWI1)
44 PORT (PORTB)
45 PORT (PORTE)
46 LUNF (TCA1)
46 OVF (TCA1)
47 HUNF (TCA1)
48 CMP0 (TCA1)
48 LCMP0 (TCA1)
49 CMP1 (TCA1)
49 LCMP1 (TCA1)
50 CMP2 (TCA1)
50 LCMP2 (TCA1)
51 ZCD (ZCD1)
52 RXC (USART3)
53 DRE (USART3)
54 TXC (USART3)
55 RXC (USART4)
56 DRE (USART4)
57 TXC (USART4)
58 PORT (PORTG)
59 ZCD (ZCD2)
60 INT (TCB4)
61 RXC (USART5)
62 DRE (USART5)
63 TXC (USART5)

## Properties
OCD_FEATURES: BREAK_PIN=PF6, BREAK_PIN_ALT=PF2
SIGNATURES: SIGNATURE0=0x1E, SIGNATURE1=0x97, SIGNATURE2=0x07

## Pinouts (pin number, pad)
QFN64: 1 PA3, 2 PA4, 3 PA5, 4 PA6, 5 PA7, 6 VDD0, 7 GND0, 8 PB0, 9 PB1, 10 PB2, 11 PB3, 12 PB4, 13 PB5, 14 PB6, 15 PB7, 16 PC0, 17 PC1, 18 PC2, 19 PC3, 20 VDD1, 21 GND1, 22 PC4, 23 PC5, 24 PC6, 25 PC7, 26 PD0, 27 PD1, 28 PD2, 29 PD3, 30 PD4, 31 PD5, 32 PD6, 33 PD7, 34 AVDD, 35 AGND, 36 PE0, 37 PE1, 38 PE2, 39 PE3, 40 PE4, 41 PE5, 42 PE6, 43 PE7, 44 PF0, 45 PF1, 46 PF2, 47 PF3, 48 PF4, 49 PF5, 50 PF6, 51 UPDI, 52 PG0, 53 PG1, 54 PG2, 55 PG3, 56 VDD2, 57 GND2, 58 PG4, 59 PG5, 60 PG6, 61 PG7, 62 PA0, 63 PA1, 64 PA2
