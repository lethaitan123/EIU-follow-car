# ATxmega256A3 device description
Architecture: AVR8_XMEGA; Family: AVR XMEGA
Programming and debug interfaces: PDI, JTAG
Registers are 8-bit, access not given, no defined reset value unless marked. A register's access mark holds for its fields unless they carry their own. Offsets are from the block's base; lines under a group give offsets from that group; [hi:lo] are bit positions; {n}, {i} and the like mark numbered series; 'fields as' and 'values as' point back to an identical list; <NAME> marks a mode.

## Ordering variants
ATXMEGA256A3-AU: TQFP64, pinout QFP_QFN_64, up to 32 MHz, 1.6 to 3.6 V
ATXMEGA256A3-MU: QFN64, pinout QFP_QFN_64, up to 32 MHz, 1.6 to 3.6 V

## Memory
prog space: start 0x00000 size 0x42000, little endian
  0x00000 APP_SECTION size 0x40000 flash, rw, executable, page 512
  0x3E000 APPTABLE_SECTION size 0x2000 flash, rw, executable, page 512
  0x40000 BOOT_SECTION size 0x2000 flash, rw, executable, page 512
data space: start 0x00000 size 0x6000, little endian
  0x00000 IO size 0x1000 io, rw
  0x01000 MAPPED_EEPROM size 0x1000 eeprom, rw
  0x02000 INTERNAL_SRAM size 0x4000 ram, rw
eeprom space: start 0x00000 size 0x1000
  0x00000 EEPROM size 0x1000 eeprom, rw, page 32
signatures space: start 0x0000 size 0x0003
  0x0000 SIGNATURES size 0x0003 signatures, ro
fuses space: start 0x0000 size 0x0006
  0x0000 FUSES size 0x0006 fuses, rw
lockbits space: start 0x00000 size 0x0001
  0x0000 LOCKBITS size 0x0001 lockbits, rw
user_signatures space: start 0x00000 size 0x0200
  0x0000 USER_SIGNATURES size 0x0200 user_signatures, rw, page 512
prod_signatures space: start 0x00000 size 0x0034
  0x0000 PROD_SIGNATURES size 0x0034 other, ro, page 512

## Peripheral instances (address, pins/pin function, parameters)
GPIO at 0x0000
OCD at 0x002E
CPU at 0x0030
  parameters: CORE_VERSION=V3X
CLK at 0x0040
PR at 0x0070
SLEEP at 0x0048
OSC at 0x0050
DFLLRC32M at 0x0060 (DFLL)
DFLLRC2M at 0x0068 (DFLL)
RST at 0x0078
WDT at 0x0080
MCU at 0x0090
PMIC at 0x00A0
DMA at 0x0100
EVSYS at 0x0180
NVM at 0x01C0
FUSE at 0x00 in fuses (NVM_FUSES)
LOCKBIT at 0x00 in lockbits (NVM_LOCKBITS)
PROD_SIGNATURES at 0x00 in prod_signatures (NVM_PROD_SIGNATURES)
ACA at 0x0380 (AC)
ACB at 0x0390 (AC)
ADCA at 0x0200 (ADC)
ADCB at 0x0240 (ADC)
DACB at 0x0320 (DAC)
RTC at 0x0400
TWIC at 0x480 (TWI)
TWIE at 0x4A0 (TWI)
PORT_CFG at PORTCFG 0x00B0
VPORT{n} at {0x10+4n} (VPORT) (n=0..3)
PORTA at 0x0600 (PORT)
PORTB at 0x0620 (PORT)
PORTC at 0x0640 (PORT)
PORTD at 0x0660 (PORT)
PORTE at 0x0680 (PORT)
PORTF at 0x06A0 (PORT)
PORTR at 0x07E0 (PORT)
TCC0 at 0x800 (TC0)
TCC1 at 0x840 (TC1)
AWEXC at 0x880 (AWEX)
HIRESC at 0x890 (HIRES)
TCD0 at 0x900 (TC0)
TCD1 at 0x940 (TC1)
HIRESD at 0x990 (HIRES)
TCE0 at 0xA00 (TC0)
TCE1 at 0xA40 (TC1)
AWEXE at 0xA80 (AWEX)
HIRESE at 0xA90 (HIRES)
TCF0 at 0xB00 (TC0)
HIRESF at 0xB90 (HIRES)
USARTC0 at 0x8A0 (USART)
USARTC1 at 0x8B0 (USART)
USARTD0 at 0x9A0 (USART)
USARTD1 at 0x9B0 (USART)
USARTE0 at 0xAA0 (USART)
USARTE1 at 0xAB0 (USART)
USARTF0 at 0xBA0 (USART)
USARTF1 at 0xBB0 (USART)
SPIC at 0x8C0 (SPI)
SPID at 0x9C0 (SPI)
SPIE at 0xAC0 (SPI)
SPIF at 0xBC0 (SPI)
IRCOM at 0x8F8
AES at 0x0C0

## Interrupts
1 OSC_OSCF — External Oscillator Failure Interrupt (NMI)
2 PORTC_INT0 — External Interrupt 0
3 PORTC_INT1 — External Interrupt 1
4 PORTR_INT0 — External Interrupt 0
5 PORTR_INT1 — External Interrupt 1
6 DMA_CH0 — Channel 0 Interrupt
7 DMA_CH1 — Channel 1 Interrupt
8 DMA_CH2 — Channel 2 Interrupt
9 DMA_CH3 — Channel 3 Interrupt
10 RTC_OVF — Overflow Interrupt
11 RTC_COMP — Compare Interrupt
12 TWIC_TWIS — TWI Slave Interrupt
13 TWIC_TWIM — TWI Master Interrupt
14 TCC0_OVF — Overflow Interrupt
15 TCC0_ERR — Error Interrupt
16 TCC0_CCA — Compare or Capture A Interrupt
17 TCC0_CCB — Compare or Capture B Interrupt
18 TCC0_CCC — Compare or Capture C Interrupt
19 TCC0_CCD — Compare or Capture D Interrupt
20 TCC1_OVF — Overflow Interrupt
21 TCC1_ERR — Error Interrupt
22 TCC1_CCA — Compare or Capture A Interrupt
23 TCC1_CCB — Compare or Capture B Interrupt
24 SPIC_INT — SPI Interrupt
25 USARTC0_RXC — Reception Complete Interrupt
26 USARTC0_DRE — Data Register Empty Interrupt
27 USARTC0_TXC — Transmission Complete Interrupt
28 USARTC1_RXC — Reception Complete Interrupt
29 USARTC1_DRE — Data Register Empty Interrupt
30 USARTC1_TXC — Transmission Complete Interrupt
31 AES_INT — AES Interrupt
32 NVM_EE — EE Interrupt
33 NVM_SPM — SPM Interrupt
34 PORTB_INT0 — External Interrupt 0
35 PORTB_INT1 — External Interrupt 1
36 ACB_AC0 — AC0 Interrupt
37 ACB_AC1 — AC1 Interrupt
38 ACB_ACW — ACW Window Mode Interrupt
39 ADCB_CH0 — Interrupt 0
40 ADCB_CH1 — Interrupt 1
41 ADCB_CH2 — Interrupt 2
42 ADCB_CH3 — Interrupt 3
43 PORTE_INT0 — External Interrupt 0
44 PORTE_INT1 — External Interrupt 1
45 TWIE_TWIS — TWI Slave Interrupt
46 TWIE_TWIM — TWI Master Interrupt
47 TCE0_OVF — Overflow Interrupt
48 TCE0_ERR — Error Interrupt
49 TCE0_CCA — Compare or Capture A Interrupt
50 TCE0_CCB — Compare or Capture B Interrupt
51 TCE0_CCC — Compare or Capture C Interrupt
52 TCE0_CCD — Compare or Capture D Interrupt
53 TCE1_OVF — Overflow Interrupt
54 TCE1_ERR — Error Interrupt
55 TCE1_CCA — Compare or Capture A Interrupt
56 TCE1_CCB — Compare or Capture B Interrupt
57 SPIE_INT — SPI Interrupt
58 USARTE0_RXC — Reception Complete Interrupt
59 USARTE0_DRE — Data Register Empty Interrupt
60 USARTE0_TXC — Transmission Complete Interrupt
61 USARTE1_RXC — Reception Complete Interrupt
62 USARTE1_DRE — Data Register Empty Interrupt
63 USARTE1_TXC — Transmission Complete Interrupt
64 PORTD_INT0 — External Interrupt 0
65 PORTD_INT1 — External Interrupt 1
66 PORTA_INT0 — External Interrupt 0
67 PORTA_INT1 — External Interrupt 1
68 ACA_AC0 — AC0 Interrupt
69 ACA_AC1 — AC1 Interrupt
70 ACA_ACW — ACW Window Mode Interrupt
71 ADCA_CH0 — Interrupt 0
72 ADCA_CH1 — Interrupt 1
73 ADCA_CH2 — Interrupt 2
74 ADCA_CH3 — Interrupt 3
77 TCD0_OVF — Overflow Interrupt
78 TCD0_ERR — Error Interrupt
79 TCD0_CCA — Compare or Capture A Interrupt
80 TCD0_CCB — Compare or Capture B Interrupt
81 TCD0_CCC — Compare or Capture C Interrupt
82 TCD0_CCD — Compare or Capture D Interrupt
83 TCD1_OVF — Overflow Interrupt
84 TCD1_ERR — Error Interrupt
85 TCD1_CCA — Compare or Capture A Interrupt
86 TCD1_CCB — Compare or Capture B Interrupt
87 SPID_INT — SPI Interrupt
88 USARTD0_RXC — Reception Complete Interrupt
89 USARTD0_DRE — Data Register Empty Interrupt
90 USARTD0_TXC — Transmission Complete Interrupt
91 USARTD1_RXC — Reception Complete Interrupt
92 USARTD1_DRE — Data Register Empty Interrupt
93 USARTD1_TXC — Transmission Complete Interrupt
104 PORTF_INT0 — External Interrupt 0
105 PORTF_INT1 — External Interrupt 1
108 TCF0_OVF — Overflow Interrupt
109 TCF0_ERR — Error Interrupt
110 TCF0_CCA — Compare or Capture A Interrupt
111 TCF0_CCB — Compare or Capture B Interrupt
112 TCF0_CCC — Compare or Capture C Interrupt
113 TCF0_CCD — Compare or Capture D Interrupt
119 USARTF0_RXC — Reception Complete Interrupt
120 USARTF0_DRE — Data Register Empty Interrupt
121 USARTF0_TXC — Transmission Complete Interrupt

## Properties
SIGNATURES: JTAGID=0x0984203F, SIGNATURE0=0x1E, SIGNATURE1=0x98, SIGNATURE2=0x42

## Pinouts (pin number, pad)
QFP_QFN_64: 1 PA3, 2 PA4, 3 PA5, 4 PA6, 5 PA7, 6 PB0, 7 PB1, 8 PB2, 9 PB3, 10 PB4, 11 PB5, 12 PB6, 13 PB7, 14 GND, 15 VCC, 16 PC0, 17 PC1, 18 PC2, 19 PC3, 20 PC4, 21 PC5, 22 PC6, 23 PC7, 24 GND, 25 VCC, 26 PD0, 27 PD1, 28 PD2, 29 PD3, 30 PD4, 31 PD5, 32 PD6, 33 PD7, 34 GND, 35 VCC, 36 PE0, 37 PE1, 38 PE2, 39 PE3, 40 PE4, 41 PE5, 42 PE6, 43 PE7, 44 GND, 45 VCC, 46 PF0, 47 PF1, 48 PF2, 49 PF3, 50 PF4, 51 PF5, 52 GND, 53 VCC, 54 PF6, 55 PF7, 56 PDI, 57 RESET, 58 PR0, 59 PR1, 60 GND, 61 AVCC, 62 PA0, 63 PA1, 64 PA2
