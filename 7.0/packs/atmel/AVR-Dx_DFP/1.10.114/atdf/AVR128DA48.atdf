# AVR128DA48 device description
Architecture: AVR8X; Family: AVR
Programming and debug interfaces: UPDI
Registers are 8-bit, read-write, reset 0x0 unless marked. A register's access mark holds for its fields unless they carry their own. Offsets are from the block's base; lines under a group give offsets from that group; [hi:lo] are bit positions; {n}, {i} and the like mark numbered series; 'fields as' and 'values as' point back to an identical list; <NAME> marks a mode.

## Ordering variants
AVR128DA48: QFN48, up to 24 MHz, -40 to 125 C, 1.8 to 5.5 V

## Memory
data space: start 0x0000 size 0x10000, little endian
  0x00001400 EEPROM size 0x0200 eeprom, rw, page 0x1
  0x00001050 FUSES size 0x10 fuses, rw, page 0x1
  0x4000 INTERNAL_SRAM size 0x4000 ram, rw
  0x00000000 IO size 0x103F io, rw
  0x00001040 LOCKBITS size 0x4 lockbits, rw, page 0x1
  0x00008000 MAPPED_PROGMEM size 0x8000 other, rw, page 0x200
  0x00001103 PROD_SIGNATURES size 0x7D signatures, ro, page 0x80
  0x00001100 SIGNATURES size 0x3 signatures, ro, page 0x80
  0x00001080 USER_SIGNATURES size 0x20 user_signatures, rw, page 0x20
prog space: start 0x0000 size 0x20000, little endian
  0x00000000 PROGMEM size 0x20000 flash, rw, executable, page 0x200

## Peripheral instances (address, pins/pin function, parameters)
AC0 at 0x0680 (AC)
  pins: N0 PD3; N1 PD0; N2 PD7; OUT0 PC6/AC0_ALT or PA7; P0 PD2; P1 PE0; P2 PE2; P3 PD6
  pin routing set by: PORTMUX.ACROUTEA.AC0
AC1 at 0x0688 (AC)
  pins: N0 PD5; N1 PD0; N2 PD7; OUT0 PC6/AC1_ALT or PA7; P0 PD2; P1 PD3; P2 PD4; P3 PD6
  pin routing set by: PORTMUX.ACROUTEA.AC1
AC2 at 0x0690 (AC)
  pins: N0 PD7; N1 PD0; N2 PD7; OUT0 PC6/AC2_ALT or PA7; P0 PD2; P1 PD4; P2 PE1; P3 PD6
  pin routing set by: PORTMUX.ACROUTEA.AC2
ADC0 at 0x0600 (ADC)
  pins: AIN{n} PD{n}/AIN0 (n=0..7); AIN8 PE0/AIN0; AIN9 PE1/AIN0; AIN10 PE2/AIN0; AIN11 PE3/AIN0; AIN16 PF0/AIN0; AIN17 PF1/AIN0; AIN18 PF2/AIN0; AIN19 PF3/AIN0; AIN20 PF4/AIN0; AIN21 PF5/AIN0
BOD at 0x0080
CCL at 0x01C0
  pins: LUT0_IN0 PA0/CCL_IN; LUT0_IN1 PA1/CCL_IN; LUT0_IN2 PA2/CCL_IN; LUT0_OUT0 PA6/CCL_ALT or PA3; LUT1_IN0 PC0/CCL_IN; LUT1_IN1 PC1/CCL_IN; LUT1_IN2 PC2/CCL_IN; LUT1_OUT0 PC6/CCL_ALT or PC3; LUT2_IN0 PD0/CCL_IN; LUT2_IN1 PD1/CCL_IN; LUT2_IN2 PD2/CCL_IN; LUT2_OUT0 PD6/CCL_ALT or PD3; LUT3_IN0 PF0/CCL_IN; LUT3_IN1 PF1/CCL_IN; LUT3_IN2 PF2/CCL_IN; LUT3_OUT0 PF3; LUT4_IN0 PB0/CCL_IN; LUT4_IN1 PB1/CCL_IN; LUT4_IN2 PB2/CCL_IN; LUT4_OUT0 PB3
  pin routing set by: PORTMUX.CCLROUTEA.LUT0, PORTMUX.CCLROUTEA.LUT1, PORTMUX.CCLROUTEA.LUT2, PORTMUX.CCLROUTEA.LUT3, PORTMUX.CCLROUTEA.LUT4
CLKCTRL at 0x0060
  pins: CLKOUT PA7; EXTCLK PA0; XTAL32K1 PF0; XTAL32K2 PF1
CPU at 0x0030
  parameters: CORE_VERSION=V4S
CPUINT at 0x0110
CRCSCAN at 0x0120
DAC0 at 0x06A0 (DAC)
  pins: OUT0 PD6
EVSYS at 0x0200
  pins: EVOUT0 PA7/EVSYS_ALT or PA2; EVOUT1 PB2; EVOUT2 PC7/EVSYS_ALT or PC2; EVOUT3 PD7/EVSYS_ALT or PD2; EVOUT4 PE2; EVOUT5 PF2
  pin routing set by: PORTMUX.EVSYSROUTEA.EVOUTA, PORTMUX.EVSYSROUTEA.EVOUTB, PORTMUX.EVSYSROUTEA.EVOUTC, PORTMUX.EVSYSROUTEA.EVOUTD, PORTMUX.EVSYSROUTEA.EVOUTE, PORTMUX.EVSYSROUTEA.EVOUTF
FUSE at 0x1050
GPR at 0x001C
LOCK at 0x1040
NVMCTRL at 0x1000
PORTA at 0x0400 (PORT)
  pins: PIN{n} PA{n}/IOPORT (n=0..7)
PORTB at 0x0420 (PORT)
  pins: PIN0 PB0/IOPORT; PIN1 PB1/IOPORT; PIN2 PB2/IOPORT; PIN3 PB3/IOPORT; PIN4 PB4/IOPORT; PIN5 PB5/IOPORT
PORTC at 0x0440 (PORT)
  pins: PIN{n} PC{n}/IOPORT (n=0..7)
PORTD at 0x0460 (PORT)
  pins: PIN{n} PD{n}/IOPORT (n=0..7)
PORTE at 0x0480 (PORT)
  pins: PIN0 PE0/IOPORT; PIN1 PE1/IOPORT; PIN2 PE2/IOPORT; PIN3 PE3/IOPORT
PORTF at 0x04A0 (PORT)
  pins: PIN0 PF0/IOPORT; PIN1 PF1/IOPORT; PIN2 PF2/IOPORT; PIN3 PF3/IOPORT; PIN4 PF4/IOPORT; PIN5 PF5/IOPORT; PIN6 PF6/IOPORT
PORTMUX at 0x05E0
PTC
  pins: XY{n} PA{n} (n=0..7); XY8 PB0; XY9 PB1; XY10 PB2; XY11 PB3; XY12 PB4; XY13 PB5; XY{n} PD{n-16} (n=16..23); XY24 PE0; XY25 PE1; XY26 PE2; XY27 PE3; XY32 PF0; XY33 PF1; XY34 PF2; XY35 PF3; XY36 PF4; XY37 PF5
RSTCTRL at 0x0040
  pins: RESET PF6/OTHER
RTC at 0x0140
SIGROW at 0x1100
SLPCTRL at 0x0050
SPI0 at 0x0940 (SPI)
  pins: MISO PE1/SPI0_ALT or PA5; MOSI PE0/SPI0_ALT or PA4; SCK PE2/SPI0_ALT or PA6; SS PE3/SPI0_ALT or PA7
  pin routing set by: PORTMUX.SPIROUTEA.SPI0
SPI1 at 0x0960 (SPI)
  pins: MISO PB5/SPI1_ALT2 or PC5/SPI1_ALT or PC1; MOSI PB4/SPI1_ALT2 or PC4/SPI1_ALT or PC0; SCK PC6/SPI1_ALT or PC2; SS PC7/SPI1_ALT or PC3
  pin routing set by: PORTMUX.SPIROUTEA.SPI1
SYSCFG at 0x0F00
TCA0 at 0x0A00 (TCA)
  pins: WO0 PF0/TCA0_ALT5 or PE0/TCA0_ALT4 or PD0/TCA0_ALT3 or PC0/TCA0_ALT2 or PB0/TCA0_ALT or PA0; WO1 PF1/TCA0_ALT5 or PE1/TCA0_ALT4 or PD1/TCA0_ALT3 or PC1/TCA0_ALT2 or PB1/TCA0_ALT or PA1; WO2 PF2/TCA0_ALT5 or PE2/TCA0_ALT4 or PD2/TCA0_ALT3 or PC2/TCA0_ALT2 or PB2/TCA0_ALT or PA2; WO3 PF3/TCA0_ALT5 or PE3/TCA0_ALT4 or PD3/TCA0_ALT3 or PC3/TCA0_ALT2 or PB3/TCA0_ALT or PA3; WO4 PF4/TCA0_ALT5 or PD4/TCA0_ALT3 or PC4/TCA0_ALT2 or PB4/TCA0_ALT or PA4; WO5 PF5/TCA0_ALT5 or PD5/TCA0_ALT3 or PC5/TCA0_ALT2 or PB5/TCA0_ALT or PA5
  pin routing set by: PORTMUX.TCAROUTEA.TCA0
TCA1 at 0x0A40 (TCA)
  pins: WO0 PC4/TCA1_ALT or PB0; WO1 PC5/TCA1_ALT or PB1; WO2 PC6/TCA1_ALT or PB2; WO3 PB3; WO4 PB4; WO5 PB5
  pin routing set by: PORTMUX.TCAROUTEA.TCA1
TCB0 at 0x0B00 (TCB)
  pins: WO0 PF4/TCB0_ALT or PA2
  pin routing set by: PORTMUX.TCBROUTEA.TCB0
TCB1 at 0x0B10 (TCB)
  pins: WO0 PF5/TCB1_ALT or PA3
  pin routing set by: PORTMUX.TCBROUTEA.TCB1
TCB2 at 0x0B20 (TCB)
  pins: WO0 PB4/TCB2_ALT or PC0
  pin routing set by: PORTMUX.TCBROUTEA.TCB2
TCB3 at 0x0B30 (TCB)
  pins: WO0 PC1/TCB3_ALT or PB5
  pin routing set by: PORTMUX.TCBROUTEA.TCB3
TCD0 at 0x0B80 (TCD)
  pins: WOA PF0/TCD0_ALT2 or PB4/TCD0_ALT or PA4; WOB1 PF1/TCD0_ALT2 or PB5/TCD0_ALT or PA5; WOC2 PF2/TCD0_ALT2 or PA6; WOD3 PF3/TCD0_ALT2 or PA7
  pin routing set by: PORTMUX.TCDROUTEA.TCD0
TWI0 at 0x0900 (TWI)
  pins: SCL PC3/I2C0_ALT2 or PA3/I2C0_ALT1 or PA3/I2C0; SCL_DUAL PC7/I2C0_ALT2 or PC7/I2C0_ALT1 or PC3/I2C0; SDA PC2/I2C0_ALT2 or PA2/I2C0_ALT1 or PA2/I2C0; SDA_DUAL PC6/I2C0_ALT2 or PC6/I2C0_ALT1 or PC2/I2C0
  pin routing set by: PORTMUX.TWIROUTEA.TWI0
TWI1 at 0x0920 (TWI)
  pins: SCL PB3/I2C1_ALT2 or PF3/I2C1_ALT1 or PF3/I2C1; SCL_DUAL PB3/I2C1; SDA PB2/I2C1_ALT2 or PF2/I2C1_ALT1 or PF2/I2C1; SDA_DUAL PB2/I2C1
  pin routing set by: PORTMUX.TWIROUTEA.TWI1
USART0 at 0x0800 (USART)
  pins: RXD PA5/USART0_ALT or PA1; TXD PA4/USART0_ALT or PA0; XCK PA6/USART0_ALT or PA2; XDIR PA7/USART0_ALT or PA3
  pin routing set by: PORTMUX.USARTROUTEA.USART0
USART1 at 0x0820 (USART)
  pins: RXD PC5/USART1_ALT or PC1; TXD PC4/USART1_ALT or PC0; XCK PC6/USART1_ALT or PC2; XDIR PC7/USART1_ALT or PC3
  pin routing set by: PORTMUX.USARTROUTEA.USART1
USART2 at 0x0840 (USART)
  pins: RXD PF5/USART2_ALT or PF1; TXD PF4/USART2_ALT or PF0; XCK PF2; XDIR PF3
  pin routing set by: PORTMUX.USARTROUTEA.USART2
USART3 at 0x0860 (USART)
  pins: RXD PB5/USART3_ALT or PB1; TXD PB4/USART3_ALT or PB0; XCK PB2; XDIR PB3
  pin routing set by: PORTMUX.USARTROUTEA.USART3
USART4 at 0x0880 (USART)
  pins: RXD PE1; TXD PE0; XCK PE2; XDIR PE3
  pin routing set by: PORTMUX.USARTROUTEB.USART4
USERROW at 0x1080
VPORTA at 0x0000 (VPORT)
VPORTB at 0x0004 (VPORT)
VPORTC at 0x0008 (VPORT)
VPORTD at 0x000C (VPORT)
VPORTE at 0x0010 (VPORT)
VPORTF at 0x0014 (VPORT)
VREF at 0x00A0
WDT at 0x0100
ZCD0 at 0x06C0 (ZCD)
  pins: IN PD1; OUT PC7/ZCD0_ALT or PA7
  pin routing set by: PORTMUX.ZCDROUTEA.ZCD0
ZCD1 at 0x06C8 (ZCD)
  pins: IN PE3; OUT PC7/ZCD1_ALT or PA7
  pin routing set by: PORTMUX.ZCDROUTEA.ZCD1

## Interrupts
1 NMI (CRCSCAN)
2 VLM (BOD)
3 CNT (RTC)
4 PIT (RTC)
5 CCL
6 PORT (PORTA)
7 LUNF (TCA0)
7 OVF (TCA0)
8 HUNF (TCA0)
9 CMP0 (TCA0)
9 LCMP0 (TCA0)
10 CMP1 (TCA0)
10 LCMP1 (TCA0)
11 CMP2 (TCA0)
11 LCMP2 (TCA0)
12 INT (TCB0)
13 INT (TCB1)
14 OVF (TCD0)
15 TRIG (TCD0)
16 TWIS (TWI0)
17 TWIM (TWI0)
18 INT (SPI0)
19 RXC (USART0)
20 DRE (USART0)
21 TXC (USART0)
22 PORT (PORTD)
23 AC (AC0)
24 RESRDY (ADC0)
25 WCMP (ADC0)
26 ZCD (ZCD0)
27 PTC
28 AC (AC1)
29 PORT (PORTC)
30 INT (TCB2)
31 RXC (USART1)
32 DRE (USART1)
33 TXC (USART1)
34 PORT (PORTF)
35 EE (NVMCTRL)
36 INT (SPI1)
37 RXC (USART2)
38 DRE (USART2)
39 TXC (USART2)
40 AC (AC2)
41 INT (TCB3)
42 TWIS (TWI1)
43 TWIM (TWI1)
44 PORT (PORTB)
45 PORT (PORTE)
46 LUNF (TCA1)
46 OVF (TCA1)
47 HUNF (TCA1)
48 CMP0 (TCA1)
48 LCMP0 (TCA1)
49 CMP1 (TCA1)
49 LCMP1 (TCA1)
50 CMP2 (TCA1)
50 LCMP2 (TCA1)
51 ZCD (ZCD1)
52 RXC (USART3)
53 DRE (USART3)
54 TXC (USART3)
55 RXC (USART4)
56 DRE (USART4)
57 TXC (USART4)

## Properties
OCD_FEATURES: BREAK_PIN=PF6, BREAK_PIN_ALT=PF2
SIGNATURES: SIGNATURE0=0x1E, SIGNATURE1=0x97, SIGNATURE2=0x08

## Pinouts (pin number, pad)
QFN48: 1 PA5, 2 PA6, 3 PA7, 4 PB0, 5 PB1, 6 PB2, 7 PB3, 8 PB4, 9 PB5, 10 PC0, 11 PC1, 12 PC2, 13 PC3, 14 VDD0, 15 GND0, 16 PC4, 17 PC5, 18 PC6, 19 PC7, 20 PD0, 21 PD1, 22 PD2, 23 PD3, 24 PD4, 25 PD5, 26 PD6, 27 PD7, 28 AVDD, 29 AGND, 30 PE0, 31 PE1, 32 PE2, 33 PE3, 34 PF0, 35 PF1, 36 PF2, 37 PF3, 38 PF4, 39 PF5, 40 PF6, 41 UPDI, 42 VDD1, 43 GND1, 44 PA0, 45 PA1, 46 PA2, 47 PA3, 48 PA4
