# ATxmega64A1 device description
Architecture: AVR8_XMEGA; Family: AVR XMEGA
Programming and debug interfaces: PDI, JTAG
Registers are 8-bit, access not given, no defined reset value unless marked. A register's access mark holds for its fields unless they carry their own. Offsets are from the block's base; lines under a group give offsets from that group; [hi:lo] are bit positions; {n}, {i} and the like mark numbered series; 'fields as' and 'values as' point back to an identical list; <NAME> marks a mode.

## Ordering variants
ATXMEGA64A1-AU: TQFP100, up to 32 MHz, 1.6 to 3.6 V
ATXMEGA64A1-CU: CBGA100, pinout BGA100, up to 32 MHz, 1.6 to 3.6 V

## Memory
prog space: start 0x0000 size 0x11000, little endian
  0x0000 APP_SECTION size 0x10000 flash, rw, executable, page 256
  0x0F000 APPTABLE_SECTION size 0x1000 flash, rw, executable, page 256
  0x10000 BOOT_SECTION size 0x1000 flash, rw, executable, page 256
data space: start 0x0000 size 0x1000000, little endian
  0x0000 IO size 0x001000 io, rw
  0x1000 MAPPED_EEPROM size 0x000800 eeprom, rw
  0x2000 INTERNAL_SRAM size 0x001000 ram, rw
  0x3000 EXTERNAL_SRAM size 0xFFCFFF ram, rw, external
eeprom space: start 0x0000 size 0x0800
  0x0000 EEPROM size 0x0800 eeprom, rw, page 32
signatures space: start 0x0000 size 0x0003
  0x0000 SIGNATURES size 0x0003 signatures, ro
fuses space: start 0x0000 size 0x0006
  0x0000 FUSES size 0x0006 fuses, rw
lockbits space: start 0x0000 size 0x0001
  0x0000 LOCKBITS size 0x0001 lockbits, rw
user_signatures space: start 0x0000 size 0x0100
  0x0000 USER_SIGNATURES size 0x0100 user_signatures, rw, page 256
prod_signatures space: start 0x0000 size 0x0034
  0x0000 PROD_SIGNATURES size 0x0034 other, ro, page 256

## Peripheral instances (address, pins/pin function, parameters)
GPIO at 0x0000
OCD at 0x002E
CPU at 0x0030
  parameters: CORE_VERSION=V3X
CLK at 0x0040
PR at 0x0070
SLEEP at 0x0048
OSC at 0x0050
DFLLRC32M at 0x0060 (DFLL)
DFLLRC2M at 0x0068 (DFLL)
RST at 0x0078
WDT at 0x0080
MCU at 0x0090
PMIC at 0x00A0
DMA at 0x0100
EVSYS at 0x0180
NVM at 0x01C0
FUSE at 0x00 in fuses (NVM_FUSES)
LOCKBIT at 0x00 in lockbits (NVM_LOCKBITS)
PROD_SIGNATURES at 0x00 in prod_signatures (NVM_PROD_SIGNATURES)
ACA at 0x0380 (AC)
ACB at 0x0390 (AC)
ADCA at 0x0200 (ADC)
ADCB at 0x0240 (ADC)
DACA at 0x0300 (DAC)
DACB at 0x0320 (DAC)
RTC at 0x0400
EBI at 0x0440
TWIC at 0x480 (TWI)
TWID at 0x490 (TWI)
TWIE at 0x4A0 (TWI)
TWIF at 0x4B0 (TWI)
PORT_CFG at PORTCFG 0x00B0
VPORT{n} at {0x10+4n} (VPORT) (n=0..3)
PORTA at 0x0600 (PORT)
PORTB at 0x0620 (PORT)
PORTC at 0x0640 (PORT)
PORTD at 0x0660 (PORT)
PORTE at 0x0680 (PORT)
PORTF at 0x06A0 (PORT)
PORTH at 0x06E0 (PORT)
PORTJ at 0x0700 (PORT)
PORTK at 0x0720 (PORT)
PORTQ at 0x07C0 (PORT)
PORTR at 0x07E0 (PORT)
TCC0 at 0x800 (TC0)
TCC1 at 0x840 (TC1)
AWEXC at 0x880 (AWEX)
HIRESC at 0x890 (HIRES)
TCD0 at 0x900 (TC0)
TCD1 at 0x940 (TC1)
HIRESD at 0x990 (HIRES)
TCE0 at 0xA00 (TC0)
TCE1 at 0xA40 (TC1)
AWEXE at 0xA80 (AWEX)
HIRESE at 0xA90 (HIRES)
TCF0 at 0xB00 (TC0)
TCF1 at 0xB40 (TC1)
HIRESF at 0xB90 (HIRES)
USARTC0 at 0x8A0 (USART)
USARTC1 at 0x8B0 (USART)
USARTD0 at 0x9A0 (USART)
USARTD1 at 0x9B0 (USART)
USARTE0 at 0xAA0 (USART)
USARTE1 at 0xAB0 (USART)
USARTF0 at 0xBA0 (USART)
USARTF1 at 0xBB0 (USART)
SPIC at 0x8C0 (SPI)
SPID at 0x9C0 (SPI)
SPIE at 0xAC0 (SPI)
SPIF at 0xBC0 (SPI)
IRCOM at 0x8F8
AES at 0x0C0

## Interrupts
1 OSC_OSCF — External Oscillator Failure Interrupt (NMI)
2 PORTC_INT0 — External Interrupt 0
3 PORTC_INT1 — External Interrupt 1
4 PORTR_INT0 — External Interrupt 0
5 PORTR_INT1 — External Interrupt 1
6 DMA_CH0 — Channel 0 Interrupt
7 DMA_CH1 — Channel 1 Interrupt
8 DMA_CH2 — Channel 2 Interrupt
9 DMA_CH3 — Channel 3 Interrupt
10 RTC_OVF — Overflow Interrupt
11 RTC_COMP — Compare Interrupt
12 TWIC_TWIS — TWI Slave Interrupt
13 TWIC_TWIM — TWI Master Interrupt
14 TCC0_OVF — Overflow Interrupt
15 TCC0_ERR — Error Interrupt
16 TCC0_CCA — Compare or Capture A Interrupt
17 TCC0_CCB — Compare or Capture B Interrupt
18 TCC0_CCC — Compare or Capture C Interrupt
19 TCC0_CCD — Compare or Capture D Interrupt
20 TCC1_OVF — Overflow Interrupt
21 TCC1_ERR — Error Interrupt
22 TCC1_CCA — Compare or Capture A Interrupt
23 TCC1_CCB — Compare or Capture B Interrupt
24 SPIC_INT — SPI Interrupt
25 USARTC0_RXC — Reception Complete Interrupt
26 USARTC0_DRE — Data Register Empty Interrupt
27 USARTC0_TXC — Transmission Complete Interrupt
28 USARTC1_RXC — Reception Complete Interrupt
29 USARTC1_DRE — Data Register Empty Interrupt
30 USARTC1_TXC — Transmission Complete Interrupt
31 AES_INT — AES Interrupt
32 NVM_EE — EE Interrupt
33 NVM_SPM — SPM Interrupt
34 PORTB_INT0 — External Interrupt 0
35 PORTB_INT1 — External Interrupt 1
36 ACB_AC0 — AC0 Interrupt
37 ACB_AC1 — AC1 Interrupt
38 ACB_ACW — ACW Window Mode Interrupt
39 ADCB_CH0 — Interrupt 0
40 ADCB_CH1 — Interrupt 1
41 ADCB_CH2 — Interrupt 2
42 ADCB_CH3 — Interrupt 3
43 PORTE_INT0 — External Interrupt 0
44 PORTE_INT1 — External Interrupt 1
45 TWIE_TWIS — TWI Slave Interrupt
46 TWIE_TWIM — TWI Master Interrupt
47 TCE0_OVF — Overflow Interrupt
48 TCE0_ERR — Error Interrupt
49 TCE0_CCA — Compare or Capture A Interrupt
50 TCE0_CCB — Compare or Capture B Interrupt
51 TCE0_CCC — Compare or Capture C Interrupt
52 TCE0_CCD — Compare or Capture D Interrupt
53 TCE1_OVF — Overflow Interrupt
54 TCE1_ERR — Error Interrupt
55 TCE1_CCA — Compare or Capture A Interrupt
56 TCE1_CCB — Compare or Capture B Interrupt
57 SPIE_INT — SPI Interrupt
58 USARTE0_RXC — Reception Complete Interrupt
59 USARTE0_DRE — Data Register Empty Interrupt
60 USARTE0_TXC — Transmission Complete Interrupt
61 USARTE1_RXC — Reception Complete Interrupt
62 USARTE1_DRE — Data Register Empty Interrupt
63 USARTE1_TXC — Transmission Complete Interrupt
64 PORTD_INT0 — External Interrupt 0
65 PORTD_INT1 — External Interrupt 1
66 PORTA_INT0 — External Interrupt 0
67 PORTA_INT1 — External Interrupt 1
68 ACA_AC0 — AC0 Interrupt
69 ACA_AC1 — AC1 Interrupt
70 ACA_ACW — ACW Window Mode Interrupt
71 ADCA_CH0 — Interrupt 0
72 ADCA_CH1 — Interrupt 1
73 ADCA_CH2 — Interrupt 2
74 ADCA_CH3 — Interrupt 3
75 TWID_TWIS — TWI Slave Interrupt
76 TWID_TWIM — TWI Master Interrupt
77 TCD0_OVF — Overflow Interrupt
78 TCD0_ERR — Error Interrupt
79 TCD0_CCA — Compare or Capture A Interrupt
80 TCD0_CCB — Compare or Capture B Interrupt
81 TCD0_CCC — Compare or Capture C Interrupt
82 TCD0_CCD — Compare or Capture D Interrupt
83 TCD1_OVF — Overflow Interrupt
84 TCD1_ERR — Error Interrupt
85 TCD1_CCA — Compare or Capture A Interrupt
86 TCD1_CCB — Compare or Capture B Interrupt
87 SPID_INT — SPI Interrupt
88 USARTD0_RXC — Reception Complete Interrupt
89 USARTD0_DRE — Data Register Empty Interrupt
90 USARTD0_TXC — Transmission Complete Interrupt
91 USARTD1_RXC — Reception Complete Interrupt
92 USARTD1_DRE — Data Register Empty Interrupt
93 USARTD1_TXC — Transmission Complete Interrupt
94 PORTQ_INT0 — External Interrupt 0
95 PORTQ_INT1 — External Interrupt 1
96 PORTH_INT0 — External Interrupt 0
97 PORTH_INT1 — External Interrupt 1
98 PORTJ_INT0 — External Interrupt 0
99 PORTJ_INT1 — External Interrupt 1
100 PORTK_INT0 — External Interrupt 0
101 PORTK_INT1 — External Interrupt 1
104 PORTF_INT0 — External Interrupt 0
105 PORTF_INT1 — External Interrupt 1
106 TWIF_TWIS — TWI Slave Interrupt
107 TWIF_TWIM — TWI Master Interrupt
108 TCF0_OVF — Overflow Interrupt
109 TCF0_ERR — Error Interrupt
110 TCF0_CCA — Compare or Capture A Interrupt
111 TCF0_CCB — Compare or Capture B Interrupt
112 TCF0_CCC — Compare or Capture C Interrupt
113 TCF0_CCD — Compare or Capture D Interrupt
114 TCF1_OVF — Overflow Interrupt
115 TCF1_ERR — Error Interrupt
116 TCF1_CCA — Compare or Capture A Interrupt
117 TCF1_CCB — Compare or Capture B Interrupt
118 SPIF_INT — SPI Interrupt
119 USARTF0_RXC — Reception Complete Interrupt
120 USARTF0_DRE — Data Register Empty Interrupt
121 USARTF0_TXC — Transmission Complete Interrupt
122 USARTF1_RXC — Reception Complete Interrupt
123 USARTF1_DRE — Data Register Empty Interrupt
124 USARTF1_TXC — Transmission Complete Interrupt

## Properties
SIGNATURES: JTAGID=0x0964E03F, SIGNATURE0=0x1E, SIGNATURE1=0x96, SIGNATURE2=0x4E

## Pinouts (pin number, pad)
TQFP100: 1 PA6, 2 PA7, 3 GND, 4 AVCC, 5 PB0, 6 PB1, 7 PB2, 8 PB3, 9 PB4, 10 PB5, 11 PB6, 12 PB7, 13 GND, 14 VCC, 15 PC0, 16 PC1, 17 PC2, 18 PC3, 19 PC4, 20 PC5, 21 PC6, 22 PC7, 23 GND, 24 VCC, 25 PD0, 26 PD1, 27 PD2, 28 PD3, 29 PD4, 30 PD5, 31 PD6, 32 PD7, 33 GND, 34 VCC, 35 PE0, 36 PE1, 37 PE2, 38 PE3, 39 PE4, 40 PE5, 41 PE6, 42 PE7, 43 GND, 44 VCC, 45 PF0, 46 PF1, 47 PF2, 48 PF3, 49 PF4, 50 PF5, 51 PF6, 52 PF7, 53 GND, 54 VCC, 55 PH0, 56 PH1, 57 PH2, 58 PH3, 59 PH4, 60 PH5, 61 PH6, 62 PH7, 63 GND, 64 VCC, 65 PJ0, 66 PJ1, 67 PJ2, 68 PJ3, 69 PJ4, 70 PJ5, 71 PJ6, 72 PJ7, 73 GND, 74 VCC, 75 PK0, 76 PK1, 77 PK2, 78 PK3, 79 PK4, 80 PK5, 81 PK6, 82 PK7, 83 VCC, 84 GND, 85 PQ0, 86 PQ1, 87 PQ2, 88 PQ3, 89 PDI, 90 RESET, 91 PR0, 92 PR1, 93 GND, 94 AVCC, 95 PA0, 96 PA1, 97 PA2, 98 PA3, 99 PA4, 100 PA5
BGA100: A1 PK0, A2 VCC, A3 GND, A4 PJ3, A5 VCC, A6 GND, A7 PH1, A8 GND, A9 VCC, A10 PF7, B1 PK3, B2 PK2, B3 PK1, B4 PJ4, B5 PH7, B6 PH4, B7 PH2, B8 PH0, B9 PF6, B10 PF5, C1 VCC, C2 PK5, C3 PK4, C4 PJ5, C5 PJ0, C6 PH5, C7 PH3, C8 PF2, C9 PF3, C10 VCC, D1 GND, D2 PK6, D3 PK7, D4 PJ6, D5 PJ1, D6 PH6, D7 PF0, D8 PF1, D9 PF4, D10 GND, E1 PQ0, E2 PQ1, E3 PQ2, E4 PJ7, E5 PJ2, E6 PE7, E7 PE6, E8 PE5, E9 PE4, E10 PE3, F1 PR1, F2 PR0, F3 RESET, F4 PDI_DATA, F5 PQ3, F6 PC2, F7 PE2, F8 PE1, F9 PE0, F10 VCC, G1 GND, G2 PA1, G3 PA4, G4 PB3, G5 PB4, G6 PC1, G7 PC6, G8 PD7, G9 PD6, G10 GND, H1 AVCC, H2 PA2, H3 PA5, H4 PB2, H5 PB5, H6 PC0, H7 PC5, H8 PD5, H9 PD4, H10 PD3, J1 PA0, J2 PA3, J3 PB0, J4 PB1, J5 PB6, J6 PC3, J7 PC4, J8 PC7, J9 PD2, J10 PD1, K1 PA6, K2 PA7, K3 GND, K4 AVCC, K5 PB7, K6 VCC , K7 GND, K8 VCC, K9 GND, K10 PD0
