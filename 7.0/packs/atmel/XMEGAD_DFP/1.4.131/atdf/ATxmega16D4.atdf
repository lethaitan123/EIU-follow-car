# ATxmega16D4 device description
Architecture: AVR8_XMEGA; Family: AVR XMEGA
Programming and debug interfaces: PDI
Registers are 8-bit, access not given, no defined reset value unless marked. A register's access mark holds for its fields unless they carry their own. Offsets are from the block's base; lines under a group give offsets from that group; [hi:lo] are bit positions; {n}, {i} and the like mark numbered series; 'fields as' and 'values as' point back to an identical list; <NAME> marks a mode.

## Ordering variants
ATxmega16D4-AU: TQFP44, pinout QFN_QFP_44, up to 32 MHz, -40 to 85 C, 1.6 to 3.6 V
ATxmega16D4-MH: VQFN44, pinout QFN_QFP_44, up to 32 MHz, -40 to 85 C, 1.6 to 3.6 V
ATxmega16D4-CU: VFBGA49, pinout BGA_49, up to 32 MHz, -40 to 85 C, 1.6 to 3.6 V
ATxmega16D4-AN: TQFP44, pinout QFN_QFP_44, up to 32 MHz, -40 to 105 C, 1.6 to 3.6 V
ATxmega16D4-M7: VFBGA49, pinout BGA_49, up to 32 MHz, -40 to 105 C, 1.6 to 3.6 V

## Memory
prog space: start 0x0000 size 0x5000, little endian
  0x0000 APP_SECTION size 0x4000 flash, rw, executable, page 256
  0x3000 APPTABLE_SECTION size 0x1000 flash, rw, executable, page 256
  0x4000 BOOT_SECTION size 0x1000 flash, rw, executable, page 256
data space: start 0x0000 size 0x2800, little endian
  0x0000 IO size 0x1000 io, rw
  0x1000 MAPPED_EEPROM size 0x0400 eeprom, rw
  0x2000 INTERNAL_SRAM size 0x0800 ram, rw
eeprom space: start 0x0000 size 0x0400
  0x0000 EEPROM size 0x0400 eeprom, rw, page 32
signatures space: start 0x0000 size 0x0003
  0x0000 SIGNATURES size 0x0003 signatures, ro
fuses space: start 0x0000 size 0x0006
  0x0000 FUSES size 0x0006 fuses, rw
lockbits space: start 0x0000 size 0x0001
  0x0000 LOCKBITS size 0x0001 lockbits, rw
user_signatures space: start 0x0000 size 0x0100
  0x0000 USER_SIGNATURES size 0x0100 user_signatures, rw, page 256
prod_signatures space: start 0x0000 size 0x0034
  0x0000 PROD_SIGNATURES size 0x0034 other, ro, page 256

## Peripheral instances (address, pins/pin function, parameters)
GPIO at 0x0000
OCD at 0x002E
CPU at 0x0030
  parameters: CORE_VERSION=V3X
CLK at 0x0040
PR at 0x0070
SLEEP at 0x0048
OSC at 0x0050
  pins: XTAL2 PR0/XTAL; XTAL1 PR1/XTAL; TOSC2 PR0/TOSC or PE2/TOSC_ALT; TOSC1 PR1/TOSC or PE3/TOSC_ALT
DFLLRC32M at 0x0060 (DFLL)
DFLLRC2M at 0x0068 (DFLL)
RST at 0x0078
WDT at 0x0080
MCU at 0x0090
PMIC at 0x00A0
CRC at 0x0D0
EVSYS at 0x0180
NVM at 0x01C0
FUSE at 0x00 in fuses (NVM_FUSES)
LOCKBIT at 0x00 in lockbits (NVM_LOCKBITS)
PROD_SIGNATURES at 0x00 in prod_signatures (NVM_PROD_SIGNATURES)
ACA at 0x0380 (AC)
  pins: AC{n} PA{n} (n=0..7); ACOUT0 PA7/ACOUT
ADCA at 0x0200 (ADC)
  pins: ADC{n} PA{n} (n=0..7); ADC8 PB0; ADC9 PB1; ADC10 PB2; ADC11 PB3; REFA0 PA0/AREF; REFB0 PB0/AREF
RTC at 0x0400
TWIC at 0x480 (TWI)
  pins: SDA PC0; SCL PC1
TWIE at 0x4A0 (TWI)
  pins: SDA PE0; SCL PE1
PORT_CFG at PORTCFG 0x00B0
  pins: CLKOUT PC7/CLKOUT or PC4/CLKOUT_ALT; EVOUT PC7/EVOUT or PC4/EVOUT_ALT; RTCOUT PC6/RTCOUTC
  pin routing set by: CLKOUT, CLKEVPIN, EVOUT
VPORT{n} at {0x10+4n} (VPORT) (n=0..3)
PORTA at 0x0600 (PORT)
  pins: P{n} PA{n} (n=0..7)
PORTB at 0x0620 (PORT)
  pins: P0 PB0; P1 PB1; P2 PB2; P3 PB3
PORTC at 0x0640 (PORT)
  pins: P{n} PC{n} (n=0..7)
PORTD at 0x0660 (PORT)
  pins: P{n} PD{n} (n=0..7)
PORTE at 0x0680 (PORT)
  pins: P0 PE0; P1 PE1; P2 PE2; P3 PE3
PORTR at 0x07E0 (PORT)
  pins: P0 PR0; P1 PR1
TCC0 at 0x800 (TC0)
  pins: OC0A PC0/TCC or PC4/TCC_ALT; OC0B PC1/TCC or PC5/TCC_ALT; OC0C PC2/TCC or PC6/TCC_ALT; OC0D PC3/TCC or PC7/TCC_ALT
  pin routing set by: TC0A, TC0B, TC0C, TC0D
TCC1 at 0x840 (TC1)
  pins: OC1A PC4/TCC; OC1B PC5/TCC
AWEXC at 0x880 (AWEX)
  pins: OC0ALS PC0/AWEX; OC0AHS PC1/AWEX; OC0BLS PC2/AWEX; OC0BHS PC3/AWEX; OC0CLS PC4/AWEX; OC0CHS PC5/AWEX; OC0DLS PC6/AWEX; OC0DHS PC7/AWEX
HIRESC at 0x890 (HIRES)
TCD0 at 0x900 (TC0)
  pins: OC0A PD0/TCC; OC0B PD1/TCC; OC0C PD2/TCC; OC0D PD3/TCC
TCE0 at 0xA00 (TC0)
  pins: OC0A PE0/TCE; OC0B PE1/TCE; OC0C PE2/TCE; OC0D PE3/TCE
TCC2 at 0x800 (TC2)
  pins: LOC2A PC0; LOC2B PC1; LOC2C PC2; LOC2D PC3; HOC2A PC4; HOC2B PC5; HOC2C PC6; HOC2D PC7
USARTC0 at 0x8A0 (USART)
  pins: XCK PC1 or PC5/USART_ALT; RXD PC2 or PC6/USART_ALT; TXD PC3 or PC7/USART_ALT
  pin routing set by: USART0
USARTD0 at 0x9A0 (USART)
  pins: XCK PD1/TCC; RXD PD2/TCC; TXD PD3/TCC
SPIC at 0x8C0 (SPI)
  pins: SS PC4 or PC4/SPI_ALT; MOSI PC5 or PC7/SPI_ALT; MISO PC6 or PC6/SPI_ALT; SCK PC7 or PC5/SPI_ALT
  pin routing set by: SPI
SPID at 0x9C0 (SPI)
  pins: SS PD4; MOSI PD5; MISO PD6; SCK PD7
IRCOM at 0x8F8

## Interrupts
1 OSC_OSCF — External Oscillator Failure Interrupt (NMI)
2 PORTC_INT0 — External Interrupt 0
3 PORTC_INT1 — External Interrupt 1
4 PORTR_INT0 — External Interrupt 0
5 PORTR_INT1 — External Interrupt 1
10 RTC_OVF — Overflow Interrupt
11 RTC_COMP — Compare Interrupt
12 TWIC_TWIS — TWI Slave Interrupt
13 TWIC_TWIM — TWI Master Interrupt
14 TCC0_OVF — Overflow Interrupt
15 TCC0_ERR — Error Interrupt
16 TCC0_CCA — Compare or Capture A Interrupt
17 TCC0_CCB — Compare or Capture B Interrupt
18 TCC0_CCC — Compare or Capture C Interrupt
19 TCC0_CCD — Compare or Capture D Interrupt
20 TCC1_OVF — Overflow Interrupt
21 TCC1_ERR — Error Interrupt
22 TCC1_CCA — Compare or Capture A Interrupt
23 TCC1_CCB — Compare or Capture B Interrupt
24 SPIC_INT — SPI Interrupt
25 USARTC0_RXC — Reception Complete Interrupt
26 USARTC0_DRE — Data Register Empty Interrupt
27 USARTC0_TXC — Transmission Complete Interrupt
32 NVM_EE — EE Interrupt
33 NVM_SPM — SPM Interrupt
34 PORTB_INT0 — External Interrupt 0
35 PORTB_INT1 — External Interrupt 1
43 PORTE_INT0 — External Interrupt 0
44 PORTE_INT1 — External Interrupt 1
45 TWIE_TWIS — TWI Slave Interrupt
46 TWIE_TWIM — TWI Master Interrupt
47 TCE0_OVF — Overflow Interrupt
48 TCE0_ERR — Error Interrupt
49 TCE0_CCA — Compare or Capture A Interrupt
50 TCE0_CCB — Compare or Capture B Interrupt
51 TCE0_CCC — Compare or Capture C Interrupt
52 TCE0_CCD — Compare or Capture D Interrupt
64 PORTD_INT0 — External Interrupt 0
65 PORTD_INT1 — External Interrupt 1
66 PORTA_INT0 — External Interrupt 0
67 PORTA_INT1 — External Interrupt 1
68 ACA_AC0 — AC0 Interrupt
69 ACA_AC1 — AC1 Interrupt
70 ACA_ACW — ACW Window Mode Interrupt
71 ADCA_CH0 — Interrupt 0
72 ADCA_CH1 — Interrupt 1
73 ADCA_CH2 — Interrupt 2
74 ADCA_CH3 — Interrupt 3
77 TCD0_OVF — Overflow Interrupt
78 TCD0_ERR — Error Interrupt
79 TCD0_CCA — Compare or Capture A Interrupt
80 TCD0_CCB — Compare or Capture B Interrupt
81 TCD0_CCC — Compare or Capture C Interrupt
82 TCD0_CCD — Compare or Capture D Interrupt
87 SPID_INT — SPI Interrupt
88 USARTD0_RXC — Reception Complete Interrupt
89 USARTD0_DRE — Data Register Empty Interrupt
90 USARTD0_TXC — Transmission Complete Interrupt

## Properties
SIGNATURES: JTAGID=0x0944203F, SIGNATURE0=0x1E, SIGNATURE1=0x94, SIGNATURE2=0x42

## Pinouts (pin number, pad)
QFN_QFP_44: 1 PA5, 2 PA6, 3 PA7, 4 PB0, 5 PB1, 6 PB2, 7 PB3, 8 GND, 9 VCC, 10 PC0, 11 PC1, 12 PC2, 13 PC3, 14 PC4, 15 PC5, 16 PC6, 17 PC7, 18 GND, 19 VCC, 20 PD0, 21 PD1, 22 PD2, 23 PD3, 24 PD4, 25 PD5, 26 PD6, 27 PD7, 28 PE0, 29 PE1, 30 GND, 31 VCC, 32 PE2, 33 PE3, 34 PDI, 35 RESET, 36 PR0, 37 PR1, 38 GND, 39 AVCC, 40 PA0, 41 PA1, 42 PA2, 43 PA3, 44 PA4
BGA_49: A1 PA3, A2 AVCC, A3 GND, A4 PR1, A5 PR0, A6 PDI, A7 PE3, B1 PA4, B2 PA1, B3 PA0, B4 GND, B5 RESET, B6 PE2, B7 VCC, C1 PA5, C2 PA2, C3 PA6, C4 PA7, C5 GND, C6 PE1, C7 GND, D1 PB1, D2 PB2, D3 PB3, D4 PB0, D5 GND, D6 PD7, D7 PE0, E1 GND, E2 GND, E3 PC3, E4 GND, E5 PD4, E6 PD5, E7 PD6, F1 VCC, F2 PC0, F3 PC4, F4 PC6, F5 PD0, F6 PD1, F7 PD3, G1 PC1, G2 PC2, G3 PC5, G4 PC7, G5 GND, G6 VCC, G7 PD2
