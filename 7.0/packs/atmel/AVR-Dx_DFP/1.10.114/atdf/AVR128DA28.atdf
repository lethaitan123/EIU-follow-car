# AVR128DA28 device description
Architecture: AVR8X; Family: AVR
Programming and debug interfaces: UPDI
Registers are 8-bit, read-write, reset 0x0 unless marked. A register's access mark holds for its fields unless they carry their own. Offsets are from the block's base; lines under a group give offsets from that group; [hi:lo] are bit positions; {n}, {i} and the like mark numbered series; 'fields as' and 'values as' point back to an identical list; <NAME> marks a mode.

## Ordering variants
AVR128DA28: SOIC28, up to 24 MHz, -40 to 125 C, 1.8 to 5.5 V

## Memory
data space: start 0x0000 size 0x10000, little endian
  0x00001400 EEPROM size 0x0200 eeprom, rw, page 0x1
  0x00001050 FUSES size 0x10 fuses, rw, page 0x1
  0x4000 INTERNAL_SRAM size 0x4000 ram, rw
  0x00000000 IO size 0x103F io, rw
  0x00001040 LOCKBITS size 0x4 lockbits, rw, page 0x1
  0x00008000 MAPPED_PROGMEM size 0x8000 other, rw, page 0x200
  0x00001103 PROD_SIGNATURES size 0x7D signatures, ro, page 0x80
  0x00001100 SIGNATURES size 0x3 signatures, ro, page 0x80
  0x00001080 USER_SIGNATURES size 0x20 user_signatures, rw, page 0x20
prog space: start 0x0000 size 0x20000, little endian
  0x00000000 PROGMEM size 0x20000 flash, rw, executable, page 0x200

## Peripheral instances (address, pins/pin function, parameters)
AC0 at 0x0680 (AC)
  pins: N0 PD3; N1 PD0; N2 PD7; OUT0 PA7; P0 PD2; P3 PD6
  pin routing set by: PORTMUX.ACROUTEA.AC0
AC1 at 0x0688 (AC)
  pins: N0 PD5; N1 PD0; N2 PD7; OUT0 PA7; P0 PD2; P1 PD3; P2 PD4; P3 PD6
  pin routing set by: PORTMUX.ACROUTEA.AC1
AC2 at 0x0690 (AC)
  pins: N0 PD7; N1 PD0; N2 PD7; OUT0 PA7; P0 PD2; P1 PD4; P3 PD6
  pin routing set by: PORTMUX.ACROUTEA.AC2
ADC0 at 0x0600 (ADC)
  pins: AIN{n} PD{n}/AIN0 (n=0..7); AIN16 PF0/AIN0; AIN17 PF1/AIN0
BOD at 0x0080
CCL at 0x01C0
  pins: LUT0_IN0 PA0/CCL_IN; LUT0_IN1 PA1/CCL_IN; LUT0_IN2 PA2/CCL_IN; LUT0_OUT0 PA6/CCL_ALT or PA3; LUT1_IN0 PC0/CCL_IN; LUT1_IN1 PC1/CCL_IN; LUT1_IN2 PC2/CCL_IN; LUT1_OUT0 PC3; LUT2_IN0 PD0/CCL_IN; LUT2_IN1 PD1/CCL_IN; LUT2_IN2 PD2/CCL_IN; LUT2_OUT0 PD6/CCL_ALT or PD3; LUT3_IN0 PF0/CCL_IN; LUT3_IN1 PF1/CCL_IN
  pin routing set by: PORTMUX.CCLROUTEA.LUT0, PORTMUX.CCLROUTEA.LUT1, PORTMUX.CCLROUTEA.LUT2
CLKCTRL at 0x0060
  pins: CLKOUT PA7; EXTCLK PA0; XTAL32K1 PF0; XTAL32K2 PF1
CPU at 0x0030
  parameters: CORE_VERSION=V4S
CPUINT at 0x0110
CRCSCAN at 0x0120
DAC0 at 0x06A0 (DAC)
  pins: OUT0 PD6
EVSYS at 0x0200
  pins: EVOUT0 PA7/EVSYS_ALT or PA2; EVOUT2 PC2; EVOUT3 PD7/EVSYS_ALT or PD2
  pin routing set by: PORTMUX.EVSYSROUTEA.EVOUTA, PORTMUX.EVSYSROUTEA.EVOUTC, PORTMUX.EVSYSROUTEA.EVOUTD
FUSE at 0x1050
GPR at 0x001C
LOCK at 0x1040
NVMCTRL at 0x1000
PORTA at 0x0400 (PORT)
  pins: PIN{n} PA{n}/IOPORT (n=0..7)
PORTC at 0x0440 (PORT)
  pins: PIN0 PC0/IOPORT; PIN1 PC1/IOPORT; PIN2 PC2/IOPORT; PIN3 PC3/IOPORT
PORTD at 0x0460 (PORT)
  pins: PIN{n} PD{n}/IOPORT (n=0..7)
PORTF at 0x04A0 (PORT)
  pins: PIN0 PF0/IOPORT; PIN1 PF1/IOPORT; PIN6 PF6/IOPORT
PORTMUX at 0x05E0
PTC
  pins: XY{n} PA{n} (n=0..7); XY{n} PD{n-16} (n=16..23); XY32 PF0; XY33 PF1
RSTCTRL at 0x0040
  pins: RESET PF6/OTHER
RTC at 0x0140
SIGROW at 0x1100
SLPCTRL at 0x0050
SPI0 at 0x0940 (SPI)
  pins: MISO PA5; MOSI PA4; SCK PA6; SS PA7
  pin routing set by: PORTMUX.SPIROUTEA.SPI0
SPI1 at 0x0960 (SPI)
  pins: MISO PC1; MOSI PC0; SCK PC2; SS PC3
  pin routing set by: PORTMUX.SPIROUTEA.SPI1
SYSCFG at 0x0F00
TCA0 at 0x0A00 (TCA)
  pins: WO0 PF0/TCA0_ALT5 or PD0/TCA0_ALT3 or PC0/TCA0_ALT2 or PA0; WO1 PF1/TCA0_ALT5 or PD1/TCA0_ALT3 or PC1/TCA0_ALT2 or PA1; WO2 PD2/TCA0_ALT3 or PC2/TCA0_ALT2 or PA2; WO3 PD3/TCA0_ALT3 or PC3/TCA0_ALT2 or PA3; WO4 PD4/TCA0_ALT3 or PA4; WO5 PD5/TCA0_ALT3 or PA5
  pin routing set by: PORTMUX.TCAROUTEA.TCA0
TCB0 at 0x0B00 (TCB)
  pins: WO0 PA2
  pin routing set by: PORTMUX.TCBROUTEA.TCB0
TCB1 at 0x0B10 (TCB)
  pins: WO0 PA3
  pin routing set by: PORTMUX.TCBROUTEA.TCB1
TCB2 at 0x0B20 (TCB)
  pins: WO0 PC0
  pin routing set by: PORTMUX.TCBROUTEA.TCB2
TCD0 at 0x0B80 (TCD)
  pins: WOA PF0/TCD0_ALT2 or PA4; WOB1 PF1/TCD0_ALT2 or PA5; WOC2 PA6; WOD3 PA7
  pin routing set by: PORTMUX.TCDROUTEA.TCD0
TWI0 at 0x0900 (TWI)
  pins: SCL PC3/I2C0_ALT2 or PA3/I2C0_ALT1 or PA3/I2C0; SCL_DUAL PC3/I2C0; SDA PC2/I2C0_ALT2 or PA2/I2C0_ALT1 or PA2/I2C0; SDA_DUAL PC2/I2C0
  pin routing set by: PORTMUX.TWIROUTEA.TWI0
USART0 at 0x0800 (USART)
  pins: RXD PA5/USART0_ALT or PA1; TXD PA4/USART0_ALT or PA0; XCK PA6/USART0_ALT or PA2; XDIR PA7/USART0_ALT or PA3
  pin routing set by: PORTMUX.USARTROUTEA.USART0
USART1 at 0x0820 (USART)
  pins: RXD PC1; TXD PC0; XCK PC2; XDIR PC3
  pin routing set by: PORTMUX.USARTROUTEA.USART1
USART2 at 0x0840 (USART)
  pins: RXD PF1; TXD PF0
  pin routing set by: PORTMUX.USARTROUTEA.USART2
USERROW at 0x1080
VPORTA at 0x0000 (VPORT)
VPORTC at 0x0008 (VPORT)
VPORTD at 0x000C (VPORT)
VPORTF at 0x0014 (VPORT)
VREF at 0x00A0
WDT at 0x0100
ZCD0 at 0x06C0 (ZCD)
  pins: IN PD1; OUT PA7
  pin routing set by: PORTMUX.ZCDROUTEA.ZCD0

## Interrupts
1 NMI (CRCSCAN)
2 VLM (BOD)
3 CNT (RTC)
4 PIT (RTC)
5 CCL
6 PORT (PORTA)
7 LUNF (TCA0)
7 OVF (TCA0)
8 HUNF (TCA0)
9 CMP0 (TCA0)
9 LCMP0 (TCA0)
10 CMP1 (TCA0)
10 LCMP1 (TCA0)
11 CMP2 (TCA0)
11 LCMP2 (TCA0)
12 INT (TCB0)
13 INT (TCB1)
14 OVF (TCD0)
15 TRIG (TCD0)
16 TWIS (TWI0)
17 TWIM (TWI0)
18 INT (SPI0)
19 RXC (USART0)
20 DRE (USART0)
21 TXC (USART0)
22 PORT (PORTD)
23 AC (AC0)
24 RESRDY (ADC0)
25 WCMP (ADC0)
26 ZCD (ZCD0)
27 PTC
28 AC (AC1)
29 PORT (PORTC)
30 INT (TCB2)
31 RXC (USART1)
32 DRE (USART1)
33 TXC (USART1)
34 PORT (PORTF)
35 EE (NVMCTRL)
36 INT (SPI1)
37 RXC (USART2)
38 DRE (USART2)
39 TXC (USART2)
40 AC (AC2)

## Properties
OCD_FEATURES: BREAK_PIN=PF6, BREAK_PIN_ALT=PF2
SIGNATURES: SIGNATURE0=0x1E, SIGNATURE1=0x97, SIGNATURE2=0x0A

## Pinouts (pin number, pad)
SOIC28: 1 PA7, 2 PC0, 3 PC1, 4 PC2, 5 PC3, 6 PD0, 7 PD1, 8 PD2, 9 PD3, 10 PD4, 11 PD5, 12 PD6, 13 PD7, 14 AVDD, 15 AGND, 16 PF0, 17 PF1, 18 PF6, 19 UPDI, 20 VDD0, 21 GND0, 22 PA0, 23 PA1, 24 PA2, 25 PA3, 26 PA4, 27 PA5, 28 PA6
