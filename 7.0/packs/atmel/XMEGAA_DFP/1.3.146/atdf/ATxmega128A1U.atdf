# ATxmega128A1U device description
Architecture: AVR8_XMEGA; Family: AVR XMEGA
Programming and debug interfaces: PDI, JTAG
Registers are 8-bit, access not given, no defined reset value unless marked. A register's access mark holds for its fields unless they carry their own. Offsets are from the block's base; lines under a group give offsets from that group; [hi:lo] are bit positions; {n}, {i} and the like mark numbered series; 'fields as' and 'values as' point back to an identical list; <NAME> marks a mode.

## Ordering variants
ATxmega128A1U-AU: TQFP100, up to 32 MHz, -40 to 85 C, 1.6 to 3.6 V
ATxmega128A1U-CU, ATxmega128A1U-C7U: BGA100, up to 32 MHz, -40 to 85 C, 1.6 to 3.6 V
ATxmega128A1U-AN: TQFP100, up to 32 MHz, -40 to 105 C, 1.6 to 3.6 V

## Memory
prog space: start 0x00000 size 0x22000, little endian
  0x00000 APP_SECTION size 0x20000 flash, rw, executable, page 512
  0x1E000 APPTABLE_SECTION size 0x2000 flash, rw, executable, page 512
  0x20000 BOOT_SECTION size 0x2000 flash, rw, executable, page 512
data space: start 0x0000 size 0x1000000, little endian
  0x0000 IO size 0x001000 io, rw
  0x1000 MAPPED_EEPROM size 0x000800 eeprom, rw
  0x2000 INTERNAL_SRAM size 0x002000 ram, rw
  0x4000 EXTERNAL_SRAM size 0xFFBFFF ram, rw, external
eeprom space: start 0x00000 size 0x0800
  0x00000 EEPROM size 0x0800 eeprom, rw, page 32
signatures space: start 0x0000 size 0x0003
  0x0000 SIGNATURES size 0x0003 signatures, ro
fuses space: start 0x0000 size 0x0006
  0x0000 FUSES size 0x0006 fuses, rw
lockbits space: start 0x0000 size 0x0001
  0x0000 LOCKBITS size 1 lockbits, rw
user_signatures space: start 0x0000 size 0x0200
  0x0000 USER_SIGNATURES size 0x0200 user_signatures, rw, page 512
prod_signatures space: start 0x0000 size 0x0040
  0x0000 PROD_SIGNATURES size 0x0040 other, ro, page 512

## Peripheral instances (address, pins/pin function, parameters)
GPIO at 0x0000
VPORT{n} at {0x10+4n} (VPORT) (n=0..3)
OCD at 0x002E
CPU at 0x0030
  parameters: CORE_VERSION=V3XJ
CLK at 0x0040
PR at 0x0070
SLEEP at 0x0048
OSC at 0x0050
DFLLRC32M at 0x0060 (DFLL)
DFLLRC2M at 0x0068 (DFLL)
RST at 0x0078
WDT at 0x0080
MCU at 0x0090
PMIC at 0x00A0
PORTCFG at 0x00B0
  pins: CLKOUT PC7/CLKOUTC or PC4/CLKOUTC_ALT or PD7/CLKOUTD or PD4/CLKOUTD_ALT or PE7/CLKOUTE or PE4/CLKOUTE_ALT; EVOUT PC7/EVOUTC or PC4/EVOUTC_ALT or PD7/EVOUTD or PD4/EVOUTD_ALT or PE7/EVOUTE or PE4/EVOUTE_ALT; RTCOUT PC6/RTCOUTC
  pin routing set by: CLKOUT, CLKEVPIN, EVOUT
AES at 0x0C0
CRC at 0x0D0
DMA at 0x0100
EVSYS at 0x0180
NVM at 0x01C0
ADCA at 0x0200 (ADC)
  pins: ADC0 PA0/ADCPOS or PA0/GAINPOS or PA0/ADCNEG; ADC1 PA1/ADCPOS or PA1/GAINPOS or PA1/ADCNEG; ADC2 PA2/ADCPOS or PA2/GAINPOS or PA2/ADCNEG; ADC3 PA3/ADCPOS or PA3/GAINPOS or PA3/ADCNEG; ADC4 PA4/ADCPOS or PA4/GAINPOS or PA4/GAINNEG; ADC5 PA5/ADCPOS or PA5/GAINPOS or PA5/GAINNEG; ADC6 PA6/ADCPOS or PA6/GAINPOS or PA6/GAINNEG; ADC7 PA7/ADCPOS or PA7/GAINPOS or PA7/GAINNEG; ADC{n} PB{n-8}/ADCPOS (n=8..15); REFA0 PA0/AREF; REFB0 PB0/AREF
ADCB at 0x0240 (ADC)
  pins: ADC0 PB0/ADCPOS or PB0/GAINPOS; ADC1 PB1/ADCPOS or PB1/GAINPOS; ADC2 PB2/ADCPOS or PB2/GAINPOS; ADC3 PB3/ADCPOS or PB3/GAINPOS; ADC4 PB4/ADCPOS or PB4/GAINPOS or PB4/ADCNEG or PB4/GAINNEG; ADC5 PB5/ADCPOS or PB5/GAINPOS or PB5/ADCNEG or PB5/GAINNEG; ADC6 PB6/ADCPOS or PB6/GAINPOS or PB6/ADCNEG or PB6/GAINNEG; ADC7 PB7/ADCPOS or PB7/GAINPOS or PB7/ADCNEG or PB7/GAINNEG; REFA0 PA0/AREF; REFB0 PB0/AREF
DACA at 0x0300 (DAC)
  pins: DAC0 PA2; DAC1 PA3; REFA0 PA0/AREF; REFB0 PB0/AREF
DACB at 0x0320 (DAC)
  pins: DAC0 PB2; DAC1 PB3; REFA0 PA0/AREF; REFB0 PB0/AREF
ACA at 0x0380 (AC)
  pins: AC0 PA0/ACPOS or PA0/ACNEG; AC1 PA1/ACPOS or PA1/ACNEG; AC2 PA2/ACPOS; AC3 PA3/ACPOS or PA3/ACNEG; AC4 PA4/ACPOS; AC5 PA5/ACPOS or PA5/ACNEG; AC6 PA6/ACPOS; AC7 PA7/ACNEG; ACOUT1 PA6/ACOUT; ACOUT0 PA7/ACOUT
ACB at 0x0390 (AC)
  pins: AC0 PB0/ACPOS or PB0/ACNEG; AC1 PB1/ACPOS or PB1/ACNEG; AC2 PB2/ACPOS; AC3 PB3/ACPOS or PB3/ACNEG; AC4 PB4/ACPOS; AC5 PB5/ACPOS or PB5/ACNEG; AC6 PB6/ACPOS; AC7 PB7/ACNEG; ACOUT1 PB6/ACOUT; ACOUT0 PB7/ACOUT
RTC at 0x0400
EBI at 0x0440
  pins: PORT{n:02} PH{n}/EBIPORT0 (n=0..7); PORT{n} PJ{n-10}/EBIPORT1 (n=10..17); PORT{n} PK{n-20}/EBIPORT2 (n=20..27); PORT{n} PF{n-30}/EBIPORT3 (n=30..37)
TWIC at 0x480 (TWI)
  pins: SDA PC0; SCL PC1
TWID at 0x490 (TWI)
  pins: SDA PD0; SCL PD1
TWIE at 0x4A0 (TWI)
  pins: SDA PE0; SCL PE1
TWIF at 0x4B0 (TWI)
  pins: SDA PF0; SCL PF1
USB at 0x4C0
  pins: DN PD6; DP PD7
PORTA at 0x0600 (PORT)
  pins: P{n} PA{n} (n=0..7)
PORTB at 0x0620 (PORT)
  pins: P{n} PB{n} (n=0..7)
PORTC at 0x0640 (PORT)
  pins: P{n} PC{n} (n=0..7)
PORTD at 0x0660 (PORT)
  pins: P{n} PD{n} (n=0..7)
PORTE at 0x0680 (PORT)
  pins: P{n} PE{n} (n=0..7)
PORTF at 0x06A0 (PORT)
  pins: P{n} PF{n} (n=0..7)
PORTH at 0x06E0 (PORT)
  pins: P{n} PH{n} (n=0..7)
PORTJ at 0x0700 (PORT)
  pins: P{n} PJ{n} (n=0..7)
PORTK at 0x0720 (PORT)
  pins: P{n} PK{n} (n=0..7)
PORTQ at 0x07C0 (PORT)
  pins: P0 PQ0; P1 PQ1; P2 PQ2; P3 PQ3
PORTR at 0x07E0 (PORT)
  pins: P0 PR0; P1 PR1
TCC0 at 0x800 (TC0)
  pins: OC0A PC0/TCC or PC4/TCC_ALT; OC0B PC1/TCC or PC5/TCC_ALT; OC0C PC2/TCC or PC6/TCC_ALT; OC0D PC3/TCC or PC7/TCC_ALT
TCC1 at 0x840 (TC1)
  pins: OC1A PC4/TCC; OC1B PC5/TCC
TCD0 at 0x900 (TC0)
  pins: OC0A PD0/TCD; OC0B PD1/TCD; OC0C PD2/TCD; OC0D PD3/TCD
TCD1 at 0x940 (TC1)
  pins: OC1A PD4/TCD; OC1B PD5/TCD
TCE0 at 0xA00 (TC0)
  pins: OC0A PE0; OC0B PE1; OC0C PE2; OC0D PE3
TCE1 at 0xA40 (TC1)
  pins: OC1A PE4; OC1B PE5
TCF0 at 0xB00 (TC0)
  pins: OC0A PF0; OC0B PF1; OC0C PF2; OC0D PF3
TCF1 at 0xB40 (TC1)
  pins: OC1A PF4; OC1B PF5
TCC2 at 0x800 (TC2)
  pins: LOC2A PC0; LOC2B PC1; LOC2C PC2; LOC2D PC3; HOC2A PC4; HOC2B PC5; HOC2C PC6; HOC2D PC7
TCD2 at 0x900 (TC2)
  pins: LOC2A PD0; LOC2B PD1; LOC2C PD2; LOC2D PD3; HOC2A PD4; HOC2B PD5; HOC2C PD6; HOC2D PD7
TCE2 at 0xA00 (TC2)
  pins: LOC2A PE0; LOC2B PE1; LOC2C PE2; LOC2D PE3; HOC2A PE4; HOC2B PE5; HOC2C PE6; HOC2D PE7
TCF2 at 0xB00 (TC2)
  pins: LOC2A PF0; LOC2B PF1; LOC2C PF2; LOC2D PF3; HOC2A PF4; HOC2B PF5; HOC2C PF6; HOC2D PF7
AWEXC at 0x880 (AWEX)
  pins: OC0ALS PC0; OC0AHS PC1; OC0BLS PC2; OC0BHS PC3; OC0CLS PC4; OC0CHS PC5; OC0DLS PC6; OC0DHS PC7
AWEXE at 0xA80 (AWEX)
  pins: OC0ALS PE0; OC0AHS PE1; OC0BLS PE2; OC0BHS PE3; OC0CLS PE4; OC0CHS PE5; OC0DLS PE6; OC0DHS PE7
HIRESC at 0x890 (HIRES)
HIRESD at 0x990 (HIRES)
HIRESE at 0xA90 (HIRES)
HIRESF at 0xB90 (HIRES)
USARTC0 at 0x8A0 (USART)
  pins: XCK PC1 or PC5/USART_ALT; RXD PC2 or PC6/USART_ALT; TXD PC3 or PC7/USART_ALT
USARTC1 at 0x8B0 (USART)
  pins: XCK PC5; RXD PC6; TXD PC7
USARTD0 at 0x9A0 (USART)
  pins: XCK PD1; RXD PD2; TXD PD3
USARTD1 at 0x9B0 (USART)
  pins: XCK PD5; RXD PD6; TXD PD7
USARTE0 at 0xAA0 (USART)
  pins: XCK PE1; RXD PE2; TXD PE3
USARTE1 at 0xAB0 (USART)
  pins: XCK PE5; RXD PE6; TXD PE7
USARTF0 at 0xBA0 (USART)
  pins: XCK PF1; RXD PF2; TXD PF3
USARTF1 at 0xBB0 (USART)
  pins: XCK PF5; RXD PF6; TXD PF7
SPIC at 0x8C0 (SPI)
  pins: SS PC4; MOSI PC5; MISO PC6; SCK PC7
SPID at 0x9C0 (SPI)
  pins: SS PD4; MOSI PD5; MISO PD6; SCK PD7
SPIE at 0xAC0 (SPI)
  pins: SS PE4; MOSI PE5; MISO PE6; SCK PE7
SPIF at 0xBC0 (SPI)
  pins: SS PF4; MOSI PF5; MISO PF6; SCK PF7
IRCOM at 0x8F8
FUSE at 0x00 in fuses (NVM_FUSES)
LOCKBIT at 0x00 in lockbits (NVM_LOCKBITS)
PROD_SIGNATURES at 0x00 in prod_signatures (NVM_PROD_SIGNATURES)

## Interrupts
1 OSC_OSCF — Oscillator Failure Interrupt (NMI)
2 PORTC_INT0 — External Interrupt 0
3 PORTC_INT1 — External Interrupt 1
4 PORTR_INT0 — External Interrupt 0
5 PORTR_INT1 — External Interrupt 1
6 DMA_CH0 — Channel 0 Interrupt
7 DMA_CH1 — Channel 1 Interrupt
8 DMA_CH2 — Channel 2 Interrupt
9 DMA_CH3 — Channel 3 Interrupt
10 RTC_OVF — Overflow Interrupt
11 RTC_COMP — Compare Interrupt
12 TWIC_TWIS — TWI Slave Interrupt
13 TWIC_TWIM — TWI Master Interrupt
14 TCC0_OVF — Overflow Interrupt
15 TCC0_ERR — Error Interrupt
16 TCC0_CCA — Compare or Capture A Interrupt
17 TCC0_CCB — Compare or Capture B Interrupt
18 TCC0_CCC — Compare or Capture C Interrupt
19 TCC0_CCD — Compare or Capture D Interrupt
20 TCC1_OVF — Overflow Interrupt
21 TCC1_ERR — Error Interrupt
22 TCC1_CCA — Compare or Capture A Interrupt
23 TCC1_CCB — Compare or Capture B Interrupt
24 SPIC_INT — SPI Interrupt
25 USARTC0_RXC — Reception Complete Interrupt
26 USARTC0_DRE — Data Register Empty Interrupt
27 USARTC0_TXC — Transmission Complete Interrupt
28 USARTC1_RXC — Reception Complete Interrupt
29 USARTC1_DRE — Data Register Empty Interrupt
30 USARTC1_TXC — Transmission Complete Interrupt
31 AES_INT — AES Interrupt
32 NVM_EE — EE Interrupt
33 NVM_SPM — SPM Interrupt
34 PORTB_INT0 — External Interrupt 0
35 PORTB_INT1 — External Interrupt 1
36 ACB_AC0 — AC0 Interrupt
37 ACB_AC1 — AC1 Interrupt
38 ACB_ACW — ACW Window Mode Interrupt
39 ADCB_CH0 — Interrupt 0
40 ADCB_CH1 — Interrupt 1
41 ADCB_CH2 — Interrupt 2
42 ADCB_CH3 — Interrupt 3
43 PORTE_INT0 — External Interrupt 0
44 PORTE_INT1 — External Interrupt 1
45 TWIE_TWIS — TWI Slave Interrupt
46 TWIE_TWIM — TWI Master Interrupt
47 TCE0_OVF — Overflow Interrupt
48 TCE0_ERR — Error Interrupt
49 TCE0_CCA — Compare or Capture A Interrupt
50 TCE0_CCB — Compare or Capture B Interrupt
51 TCE0_CCC — Compare or Capture C Interrupt
52 TCE0_CCD — Compare or Capture D Interrupt
53 TCE1_OVF — Overflow Interrupt
54 TCE1_ERR — Error Interrupt
55 TCE1_CCA — Compare or Capture A Interrupt
56 TCE1_CCB — Compare or Capture B Interrupt
57 SPIE_INT — SPI Interrupt
58 USARTE0_RXC — Reception Complete Interrupt
59 USARTE0_DRE — Data Register Empty Interrupt
60 USARTE0_TXC — Transmission Complete Interrupt
61 USARTE1_RXC — Reception Complete Interrupt
62 USARTE1_DRE — Data Register Empty Interrupt
63 USARTE1_TXC — Transmission Complete Interrupt
64 PORTD_INT0 — External Interrupt 0
65 PORTD_INT1 — External Interrupt 1
66 PORTA_INT0 — External Interrupt 0
67 PORTA_INT1 — External Interrupt 1
68 ACA_AC0 — AC0 Interrupt
69 ACA_AC1 — AC1 Interrupt
70 ACA_ACW — ACW Window Mode Interrupt
71 ADCA_CH0 — Interrupt 0
72 ADCA_CH1 — Interrupt 1
73 ADCA_CH2 — Interrupt 2
74 ADCA_CH3 — Interrupt 3
75 TWID_TWIS — TWI Slave Interrupt
76 TWID_TWIM — TWI Master Interrupt
77 TCD0_OVF — Overflow Interrupt
78 TCD0_ERR — Error Interrupt
79 TCD0_CCA — Compare or Capture A Interrupt
80 TCD0_CCB — Compare or Capture B Interrupt
81 TCD0_CCC — Compare or Capture C Interrupt
82 TCD0_CCD — Compare or Capture D Interrupt
83 TCD1_OVF — Overflow Interrupt
84 TCD1_ERR — Error Interrupt
85 TCD1_CCA — Compare or Capture A Interrupt
86 TCD1_CCB — Compare or Capture B Interrupt
87 SPID_INT — SPI Interrupt
88 USARTD0_RXC — Reception Complete Interrupt
89 USARTD0_DRE — Data Register Empty Interrupt
90 USARTD0_TXC — Transmission Complete Interrupt
91 USARTD1_RXC — Reception Complete Interrupt
92 USARTD1_DRE — Data Register Empty Interrupt
93 USARTD1_TXC — Transmission Complete Interrupt
94 PORTQ_INT0 — External Interrupt 0
95 PORTQ_INT1 — External Interrupt 1
96 PORTH_INT0 — External Interrupt 0
97 PORTH_INT1 — External Interrupt 1
98 PORTJ_INT0 — External Interrupt 0
99 PORTJ_INT1 — External Interrupt 1
100 PORTK_INT0 — External Interrupt 0
101 PORTK_INT1 — External Interrupt 1
104 PORTF_INT0 — External Interrupt 0
105 PORTF_INT1 — External Interrupt 1
106 TWIF_TWIS — TWI Slave Interrupt
107 TWIF_TWIM — TWI Master Interrupt
108 TCF0_OVF — Overflow Interrupt
109 TCF0_ERR — Error Interrupt
110 TCF0_CCA — Compare or Capture A Interrupt
111 TCF0_CCB — Compare or Capture B Interrupt
112 TCF0_CCC — Compare or Capture C Interrupt
113 TCF0_CCD — Compare or Capture D Interrupt
114 TCF1_OVF — Overflow Interrupt
115 TCF1_ERR — Error Interrupt
116 TCF1_CCA — Compare or Capture A Interrupt
117 TCF1_CCB — Compare or Capture B Interrupt
118 SPIF_INT — SPI Interrupt
119 USARTF0_RXC — Reception Complete Interrupt
120 USARTF0_DRE — Data Register Empty Interrupt
121 USARTF0_TXC — Transmission Complete Interrupt
122 USARTF1_RXC — Reception Complete Interrupt
123 USARTF1_DRE — Data Register Empty Interrupt
124 USARTF1_TXC — Transmission Complete Interrupt
125 USB_BUSEVENT — SOF, suspend, resume, reset bus event interrupts, crc, underflow, overflow and stall error interrupts
126 USB_TRNCOMPL — Transaction complete interrupt

## Properties
SIGNATURES: JTAGID=0x0974C03F, SIGNATURE0=0x1E, SIGNATURE1=0x97, SIGNATURE2=0x4C

## Pinouts (pin number, pad)
TQFP100: 1 PA6, 2 PA7, 3 GND, 4 AVCC, 5 PB0, 6 PB1, 7 PB2, 8 PB3, 9 PB4, 10 PB5, 11 PB6, 12 PB7, 13 GND, 14 VCC, 15 PC0, 16 PC1, 17 PC2, 18 PC3, 19 PC4, 20 PC5, 21 PC6, 22 PC7, 23 GND, 24 VCC, 25 PD0, 26 PD1, 27 PD2, 28 PD3, 29 PD4, 30 PD5, 31 PD6, 32 PD7, 33 GND, 34 VCC, 35 PE0, 36 PE1, 37 PE2, 38 PE3, 39 PE4, 40 PE5, 41 PE6, 42 PE7, 43 GND, 44 VCC, 45 PF0, 46 PF1, 47 PF2, 48 PF3, 49 PF4, 50 PF5, 51 PF6, 52 PF7, 53 GND, 54 VCC, 55 PH0, 56 PH1, 57 PH2, 58 PH3, 59 PH4, 60 PH5, 61 PH6, 62 PH7, 63 GND, 64 VCC, 65 PJ0, 66 PJ1, 67 PJ2, 68 PJ3, 69 PJ4, 70 PJ5, 71 PJ6, 72 PJ7, 73 GND, 74 VCC, 75 PK0, 76 PK1, 77 PK2, 78 PK3, 79 PK4, 80 PK5, 81 PK6, 82 PK7, 83 VCC, 84 GND, 85 PQ0, 86 PQ1, 87 PQ2, 88 PQ3, 89 PDI, 90 RESET, 91 PR0, 92 PR1, 93 GND, 94 AVCC, 95 PA0, 96 PA1, 97 PA2, 98 PA3, 99 PA4, 100 PA5
BGA100: A1 PK0, A2 VCC, A3 GND, A4 PJ3, A5 VCC, A6 GND, A7 PH1, A8 GND, A9 VCC, A10 PF7, B1 PK3, B2 PK2, B3 PK1, B4 PJ4, B5 PH7, B6 PH4, B7 PH2, B8 PH0, B9 PF6, B10 PF5, C1 VCC, C2 PK5, C3 PK4, C4 PJ5, C5 PJ0, C6 PH5, C7 PH3, C8 PF2, C9 PF3, C10 VCC, D1 GND, D2 PK6, D3 PK7, D4 PJ6, D5 PJ1, D6 PH6, D7 PF0, D8 PF1, D9 PF4, D10 GND, E1 PQ0, E2 PQ1, E3 PQ2, E4 PJ7, E5 PJ2, E6 PE7, E7 PE6, E8 PE5, E9 PE4, E10 PE3, F1 PR1, F2 PR0, F3 RESET, F4 PDI_DATA, F5 PQ3, F6 PC2, F7 PE2, F8 PE1, F9 PE0, F10 VCC, G1 GND, G2 PA1, G3 PA4, G4 PB3, G5 PB4, G6 PC1, G7 PC6, G8 PD7, G9 PD6, G10 GND, H1 AVCC, H2 PA2, H3 PA5, H4 PB2, H5 PB5, H6 PC0, H7 PC5, H8 PD5, H9 PD4, H10 PD3, J1 PA0, J2 PA3, J3 PB0, J4 PB1, J5 PB6, J6 PC3, J7 PC4, J8 PC7, J9 PD2, J10 PD1, K1 PA6, K2 PA7, K3 GND, K4 AVCC, K5 PB7, K6 VCC , K7 GND, K8 VCC, K9 GND, K10 PD0
