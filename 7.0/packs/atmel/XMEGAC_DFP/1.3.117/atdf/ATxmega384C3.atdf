# ATxmega384C3 device description
Architecture: AVR8_XMEGA; Family: AVR XMEGA
Programming and debug interfaces: PDI
Registers are 8-bit, access not given, no defined reset value unless marked. A register's access mark holds for its fields unless they carry their own. Offsets are from the block's base; lines under a group give offsets from that group; [hi:lo] are bit positions; {n}, {i} and the like mark numbered series; 'fields as' and 'values as' point back to an identical list; <NAME> marks a mode.

## Ordering variants
ATxmega384C3-AU: TQFP64, pinout QFP_QFN_64, up to 32 MHz, -40 to 85 C, 1.6 to 3.6 V
ATxmega384C3-MH: QFN64, pinout QFP_QFN_64, up to 32 MHz, -40 to 85 C, 1.6 to 3.6 V
ATxmega384C3-AN: TQFP64, pinout QFP_QFN_64, up to 32 MHz, -40 to 105 C, 1.6 to 3.6 V
ATxmega384C3-M7: QFN64, pinout QFP_QFN_64, up to 32 MHz, -40 to 105 C, 1.6 to 3.6 V

## Memory
prog space: start 0x00000 size 0x62000, little endian
  0x00000 APP_SECTION size 0x60000 flash, rw, executable, page 512
  0x5E000 APPTABLE_SECTION size 0x2000 flash, rw, executable, page 512
  0x60000 BOOT_SECTION size 0x2000 flash, rw, executable, page 512
data space: start 0x0000 size 0xA000, little endian
  0x0000 IO size 0x1000 io, rw
  0x1000 MAPPED_EEPROM size 0x1000 eeprom, rw
  0x2000 INTERNAL_SRAM size 0x8000 ram, rw
eeprom space: start 0x00000 size 0x1000
  0x00000 EEPROM size 0x1000 eeprom, rw, page 32
signatures space: start 0x0000 size 0x0003
  0x0000 SIGNATURES size 0x0003 signatures, ro
fuses space: start 0x0000 size 0x0006
  0x0000 FUSES size 0x0006 fuses, rw
lockbits space: start 0x0000 size 0x0001
  0x0000 LOCKBITS size 0x0001 lockbits, rw
user_signatures space: start 0x0000 size 0x0200
  0x0000 USER_SIGNATURES size 0x0200 user_signatures, rw, page 512
prod_signatures space: start 0x0000 size 0x0040
  0x0000 PROD_SIGNATURES size 0x0040 other, ro, page 512

## Peripheral instances (address, pins/pin function, parameters)
GPIO at 0x0000
VPORT{n} at {0x10+4n} (VPORT) (n=0..3)
OCD at 0x002E
CPU at 0x0030
  parameters: CORE_VERSION=V3XJ
CLK at 0x0040
PR at 0x0070
SLEEP at 0x0048
OSC at 0x0050
  pins: XTAL2 PR0/XTAL; XTAL1 PR1/XTAL; TOSC2 PE2/TOSC; TOSC1 PE3/TOSC
DFLLRC32M at 0x0060 (DFLL)
DFLLRC2M at 0x0068 (DFLL)
RST at 0x0078
WDT at 0x0080
MCU at 0x0090
PMIC at 0x00A0
PORTCFG at 0x00B0
  pins: CLKOUT PC7/CLKOUT or PC4/CLKOUT_ALT; EVOUT PC7/EVOUT or PC4/EVOUT_ALT; RTCOUT PC6/RTCOUTC
  pin routing set by: CLKOUT, CLKEVPIN, EVOUT
AES at 0x0C0
CRC at 0x0D0
DMA at 0x0100
EVSYS at 0x0180
NVM at 0x01C0
ADCA at 0x0200 (ADC)
  pins: ADC{n} PA{n} (n=0..7); ADC{n} PB{n-8} (n=8..15); REFA0 PA0/AREF; REFB0 PB0/AREF
ACA at 0x0380 (AC)
  pins: AC{n} PA{n} (n=0..7); ACOUT1 PA6/ACOUT; ACOUT0 PA7/ACOUT
RTC at 0x0400
TWIC at 0x480 (TWI)
  pins: SDA PC0; SCL PC1
TWIE at 0x4A0 (TWI)
  pins: SDA PE0; SCL PE1
USB at 0x4C0
  pins: DN PD6; DP PD7
PORTA at 0x0600 (PORT)
  pins: P{n} PA{n} (n=0..7)
PORTB at 0x0620 (PORT)
  pins: P{n} PB{n} (n=0..7)
PORTC at 0x0640 (PORT)
  pins: P{n} PC{n} (n=0..7)
PORTD at 0x0660 (PORT)
  pins: P{n} PD{n} (n=0..7)
PORTE at 0x0680 (PORT)
  pins: P{n} PE{n} (n=0..7)
PORTF at 0x06A0 (PORT)
  pins: P{n} PF{n} (n=0..7)
PORTR at 0x07E0 (PORT)
  pins: P0 PR0; P1 PR1
TCC0 at 0x800 (TC0)
  pins: OC0A PC0/TC0 or PC4/TC0_ALT; OC0B PC1/TC0 or PC5/TC0_ALT; OC0C PC2/TC0 or PC6/TC0_ALT; OC0D PC3/TC0 or PC7/TC0_ALT
  pin routing set by: TC0A, TC0B, TC0C, TC0D
TCC1 at 0x840 (TC1)
  pins: OC1A PC4/TC1; OC1B PC5/TC1
TCD0 at 0x900 (TC0)
  pins: OC0A PD0/TC0; OC0B PD1/TC0; OC0C PD2/TC0; OC0D PD3/TC0
TCE0 at 0xA00 (TC0)
  pins: OC0A PE0/TC0; OC0B PE1/TC0; OC0C PE2/TC0; OC0D PE3/TC0
TCF0 at 0xB00 (TC0)
  pins: OC0A PF0/TC0; OC0B PF1/TC0; OC0C PF2/TC0; OC0D PF3/TC0
TCC2 at 0x800 (TC2)
  pins: LOC2A PC0; LOC2B PC1; LOC2C PC2; LOC2D PC3; HOC2A PC4; HOC2B PC5; HOC2C PC6; HOC2D PC7
TCD2 at 0x900 (TC2)
  pins: LOC2A PD0; LOC2B PD1; LOC2C PD2; LOC2D PD3; HOC2A PD4; HOC2B PD5; HOC2C PD6; HOC2D PD7
TCE2 at 0xA00 (TC2)
  pins: LOC2A PE0; LOC2B PE1; LOC2C PE2; LOC2D PE3; HOC2A PE4; HOC2B PE5; HOC2C PE6; HOC2D PE7
TCF2 at 0xB00 (TC2)
  pins: LOC2A PF0; LOC2B PF1; LOC2C PF2; LOC2D PF3; HOC2A PF4; HOC2B PF5; HOC2C PF6; HOC2D PF7
AWEXC at 0x880 (AWEX)
  pins: OC0ALS PC0; OC0AHS PC1; OC0BLS PC2; OC0BHS PC3; OC0CLS PC4; OC0CHS PC5; OC0DLS PC6; OC0DHS PC7
HIRESC at 0x890 (HIRES)
USARTC0 at 0x8A0 (USART)
  pins: XCK PC1 or PC5/USART_ALT; RXD PC2 or PC6/USART_ALT; TXD PC3 or PC7/USART_ALT
  pin routing set by: USART0
USARTD0 at 0x9A0 (USART)
  pins: XCK PD1; RXD PD2; TXD PD3
USARTE0 at 0xAA0 (USART)
  pins: XCK PE1; RXD PE2; TXD PE3
SPIC at 0x8C0 (SPI)
  pins: SS PC4 or PC4/SPI_ALT; MOSI PC5 or PC7/SPI_ALT; MISO PC6 or PC6/SPI_ALT; SCK PC7 or PC5/SPI_ALT
  pin routing set by: SPI
SPID at 0x9C0 (SPI)
  pins: SS PD4; MOSI PD5; MISO PD6; SCK PD7
IRCOM at 0x8F8
FUSE at 0x00 in fuses (NVM_FUSES)
LOCKBIT at 0x00 in lockbits (NVM_LOCKBITS)
PROD_SIGNATURES at 0x00 in prod_signatures (NVM_PROD_SIGNATURES)

## Interrupts
1 OSC_OSCF — Oscillator Failure Interrupt (NMI)
2 PORTC_INT0 — External Interrupt 0
3 PORTC_INT1 — External Interrupt 1
4 PORTR_INT0 — External Interrupt 0
5 PORTR_INT1 — External Interrupt 1
6 DMA_CH0 — Channel 0 Interrupt
7 DMA_CH1 — Channel 1 Interrupt
10 RTC_OVF — Overflow Interrupt
11 RTC_COMP — Compare Interrupt
12 TWIC_TWIS — TWI Slave Interrupt
13 TWIC_TWIM — TWI Master Interrupt
14 TCC0_OVF — Overflow Interrupt
15 TCC0_ERR — Error Interrupt
16 TCC0_CCA — Compare or Capture A Interrupt
17 TCC0_CCB — Compare or Capture B Interrupt
18 TCC0_CCC — Compare or Capture C Interrupt
19 TCC0_CCD — Compare or Capture D Interrupt
20 TCC1_OVF — Overflow Interrupt
21 TCC1_ERR — Error Interrupt
22 TCC1_CCA — Compare or Capture A Interrupt
23 TCC1_CCB — Compare or Capture B Interrupt
24 SPIC_INT — SPI Interrupt
25 USARTC0_RXC — Reception Complete Interrupt
26 USARTC0_DRE — Data Register Empty Interrupt
27 USARTC0_TXC — Transmission Complete Interrupt
31 AES_INT — AES Interrupt
32 NVM_EE — EE Interrupt
33 NVM_SPM — SPM Interrupt
34 PORTB_INT0 — External Interrupt 0
35 PORTB_INT1 — External Interrupt 1
43 PORTE_INT0 — External Interrupt 0
44 PORTE_INT1 — External Interrupt 1
45 TWIE_TWIS — TWI Slave Interrupt
46 TWIE_TWIM — TWI Master Interrupt
47 TCE0_OVF — Overflow Interrupt
48 TCE0_ERR — Error Interrupt
49 TCE0_CCA — Compare or Capture A Interrupt
50 TCE0_CCB — Compare or Capture B Interrupt
51 TCE0_CCC — Compare or Capture C Interrupt
52 TCE0_CCD — Compare or Capture D Interrupt
58 USARTE0_RXC — Reception Complete Interrupt
59 USARTE0_DRE — Data Register Empty Interrupt
60 USARTE0_TXC — Transmission Complete Interrupt
64 PORTD_INT0 — External Interrupt 0
65 PORTD_INT1 — External Interrupt 1
66 PORTA_INT0 — External Interrupt 0
67 PORTA_INT1 — External Interrupt 1
68 ACA_AC0 — AC0 Interrupt
69 ACA_AC1 — AC1 Interrupt
70 ACA_ACW — ACW Window Mode Interrupt
71 ADCA_CH0 — Interrupt 0
77 TCD0_OVF — Overflow Interrupt
78 TCD0_ERR — Error Interrupt
79 TCD0_CCA — Compare or Capture A Interrupt
80 TCD0_CCB — Compare or Capture B Interrupt
81 TCD0_CCC — Compare or Capture C Interrupt
82 TCD0_CCD — Compare or Capture D Interrupt
87 SPID_INT — SPI Interrupt
88 USARTD0_RXC — Reception Complete Interrupt
89 USARTD0_DRE — Data Register Empty Interrupt
90 USARTD0_TXC — Transmission Complete Interrupt
104 PORTF_INT0 — External Interrupt 0
105 PORTF_INT1 — External Interrupt 1
108 TCF0_OVF — Overflow Interrupt
109 TCF0_ERR — Error Interrupt
110 TCF0_CCA — Compare or Capture A Interrupt
111 TCF0_CCB — Compare or Capture B Interrupt
112 TCF0_CCC — Compare or Capture C Interrupt
113 TCF0_CCD — Compare or Capture D Interrupt
125 USB_BUSEVENT — SOF, suspend, resume, reset bus event interrupts, crc, underflow, overflow and stall error interrupts
126 USB_TRNCOMPL — Transaction complete interrupt

## Properties
SIGNATURES: SIGNATURE0=0x1E, SIGNATURE1=0x98, SIGNATURE2=0x45

## Pinouts (pin number, pad)
QFP_QFN_64: 1 PA3, 2 PA4, 3 PA5, 4 PA6, 5 PA7, 6 PB0, 7 PB1, 8 PB2, 9 PB3, 10 PB4, 11 PB5, 12 PB6, 13 PB7, 14 GND, 15 VCC, 16 PC0, 17 PC1, 18 PC2, 19 PC3, 20 PC4, 21 PC5, 22 PC6, 23 PC7, 24 GND, 25 VCC, 26 PD0, 27 PD1, 28 PD2, 29 PD3, 30 PD4, 31 PD5, 32 PD6, 33 PD7, 34 GND, 35 VCC, 36 PE0, 37 PE1, 38 PE2, 39 PE3, 40 PE4, 41 PE5, 42 PE6, 43 PE7, 44 GND, 45 VCC, 46 PF0, 47 PF1, 48 PF2, 49 PF3, 50 PF4, 51 PF5, 52 GND, 53 VCC, 54 PF6, 55 PF7, 56 PDI, 57 RESET, 58 PR0, 59 PR1, 60 GND, 61 AVCC, 62 PA0, 63 PA1, 64 PA2
