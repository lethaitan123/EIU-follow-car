# ATxmega128B1 device description
Architecture: AVR8_XMEGA; Family: AVR XMEGA
Programming and debug interfaces: PDI, JTAG
Registers are 8-bit, access not given, no defined reset value unless marked. A register's access mark holds for its fields unless they carry their own. Offsets are from the block's base; lines under a group give offsets from that group; [hi:lo] are bit positions; {n}, {i} and the like mark numbered series; 'fields as' and 'values as' point back to an identical list; <NAME> marks a mode.

## Ordering variants
ATxmega128B1-AU: TQFP100, pinout QFP_100, up to 32 MHz, -40 to 85 C, 1.6 to 3.6 V
ATxmega128B1-CU: VFBGA100, pinout BGA_100, up to 32 MHz, -40 to 85 C, 1.6 to 3.6 V
ATxmega128B1-AN: TQFP100, pinout QFP_100, up to 32 MHz, -40 to 105 C, 1.6 to 3.6 V

## Memory
prog space: start 0x00000 size 0x22000, little endian
  0x00000 APP_SECTION size 0x20000 flash, rw, executable, page 256
  0x1E000 APPTABLE_SECTION size 0x2000 flash, rw, executable, page 256
  0x20000 BOOT_SECTION size 0x2000 flash, rw, executable, page 256
data space: start 0x0000 size 0x4000, little endian
  0x0000 IO size 0x1000 io, rw
  0x1000 MAPPED_EEPROM size 0x0800 eeprom, rw
  0x2000 INTERNAL_SRAM size 0x2000 ram, rw
eeprom space: start 0x00000 size 0x0800
  0x00000 EEPROM size 0x0800 eeprom, rw, page 32
signatures space: start 0x0000 size 0x0003
  0x0000 SIGNATURES size 0x0003 signatures, ro
fuses space: start 0x0000 size 0x0006
  0x0000 FUSES size 0x0006 fuses, rw
lockbits space: start 0x0000 size 0x0001
  0x0000 LOCKBITS size 0x0001 lockbits, rw
user_signatures space: start 0x0000 size 0x0100
  0x0000 USER_SIGNATURES size 0x0100 user_signatures, rw, page 256
prod_signatures space: start 0x0000 size 0x0034
  0x0000 PROD_SIGNATURES size 0x0034 other, ro, page 256

## Peripheral instances (address, pins/pin function, parameters)
GPIO at 0x0000
VPORT{n} at {0x10+4n} (VPORT) (n=0..3)
OCD at 0x002E
CPU at 0x0030
  parameters: CORE_VERSION=V3XJ
CLK at 0x0040
  pins: EXTCLK{n} PC{n}/EXTERNAL_CLOCK (n=0..7)
SLEEP at 0x0048
OSC at 0x0050
  pins: XTAL2 PR0/XTAL; XTAL1 PR1/XTAL; TOSC2 PR0/TOSC or PE6/TOSC_ALT; TOSC1 PR1/TOSC or PE7/TOSC_ALT
DFLLRC32M at 0x0060 (DFLL)
DFLLRC2M at 0x0068 (DFLL)
PR at 0x0070
RST at 0x0078
WDT at 0x0080
MCU at 0x0090
PMIC at 0x00A0
PORTCFG at 0x00B0
  pins: CLKOUT PD7/CLKOUTC or PE7/CLKOUTE; EVOUT PD7/EVOUTC or PE7/EVOUT; RTCOUT PD6/RTCOUTC
  pin routing set by: CLKOUT, EVOUT, RTCOUT
AES at 0x0C0
CRC at 0x0D0
DMA at 0x0100
EVSYS at 0x0180
NVM at 0x01C0
ADCA at 0x0200 (ADC)
  pins: ADC{n} PA{n} (n=0..7); ADC{n} PB{n-8} (n=8..15); REFA0 PA0/AREF; REFB0 PB0/AREF
ADCB at 0x0240 (ADC)
  pins: ADC{n} PB{n} (n=0..7); REFA0 PA0/AREF; REFB0 PB0/AREF
ACA at 0x0380 (AC)
  pins: AC{n} PA{n} (n=0..7); ACOUT1 PA6/ACOUT; ACOUT0 PA7/ACOUT
ACB at 0x0390 (AC)
  pins: AC{n} PB{n} (n=0..7); ACOUT1 PB6/ACOUT; ACOUT0 PB7/ACOUT
RTC at 0x0400
TWIC at 0x480 (TWI)
  pins: SDA PC0; SCL PC1
USB at 0x4C0
  pins: DN PD0; DP PD1
PORTA at 0x0600 (PORT)
  pins: P{n} PA{n} (n=0..7)
PORTB at 0x0620 (PORT)
  pins: P{n} PB{n} (n=0..7)
PORTC at 0x0640 (PORT)
  pins: P{n} PC{n} (n=0..7)
PORTD at 0x0660 (PORT)
  pins: P0 PD0; P1 PD1; P2 PD2
PORTE at 0x0680 (PORT)
  pins: P{n} PE{n} (n=0..7)
PORTG at 0x06C0 (PORT)
  pins: P{n} PG{n} (n=0..7)
PORTM at 0x0760 (PORT)
  pins: P{n} PM{n} (n=0..7)
PORTR at 0x07E0 (PORT)
  pins: P0 PR0; P1 PR1
TCC0 at 0x800 (TC0)
  pins: OC0A PC0/TC0 or PC4/TC0_ALT; OC0B PC1/TC0 or PC5/TC0_ALT; OC0C PC2/TC0 or PC6/TC0_ALT; OC0D PC3/TC0 or PC7/TC0_ALT
  pin routing set by: TC0A, TC0B, TC0C, TC0D
TCC1 at 0x840 (TC1)
  pins: OC1A PC4/TC1; OC1B PC5/TC1
TCE0 at 0xA00 (TC0)
  pins: OC0A PE0/TC0 or PE4/TC0_ALT; OC0B PE1/TC0 or PE5/TC0_ALT; OC0C PE2/TC0 or PE6/TC0_ALT; OC0D PE3/TC0 or PE7/TC0_ALT
  pin routing set by: TC0A, TC0B, TC0C, TC0D
TCC2 at 0x800 (TC2)
  pins: LOC2A PC0; LOC2B PC1; LOC2C PC2; LOC2D PC3; HOC2A PC4; HOC2B PC5; HOC2C PC6; HOC2D PC7
TCE2 at 0xA00 (TC2)
  pins: LOC2A PE0; LOC2B PE1; LOC2C PE2; LOC2D PE3; HOC2A PE4; HOC2B PE5; HOC2C PE6; HOC2D PE7
AWEXC at 0x880 (AWEX)
  pins: OC0ALS PC0; OC0AHS PC1; OC0BLS PC2; OC0BHS PC3; OC0CLS PC4; OC0CHS PC5; OC0DLS PC6; OC0DHS PC7
HIRESC at 0x890 (HIRES)
USARTC0 at 0x8A0 (USART)
  pins: XCK PC1 or PC5/USART_ALT; RXD PC2 or PC6/USART_ALT; TXD PC3 or PC7/USART_ALT
  pin routing set by: USART0
USARTE0 at 0xAA0 (USART)
  pins: XCK PE1 or PE5/USART_ALT; RXD PE2 or PE6/USART_ALT; TXD PE3 or PE7/USART_ALT
  pin routing set by: USART0
SPIC at 0x8C0 (SPI)
  pins: SS PC4 or PC4/SPI_ALT; MOSI PC5 or PC7/SPI_ALT; MISO PC6 or PC6/SPI_ALT; SCK PC7 or PC5/SPI_ALT
  pin routing set by: SPI
IRCOM at 0x8F8
LCD at 0x0D00
  pins: SEG39 PG0/LCD_SEG; SEG38 PG1/LCD_SEG; SEG37 PG2/LCD_SEG; SEG36 PG3/LCD_SEG; SEG35 PG4/LCD_SEG; SEG34 PG5/LCD_SEG; SEG33 PG6/LCD_SEG; SEG32 PG7/LCD_SEG; SEG31 PM0/LCD_SEG; SEG30 PM1/LCD_SEG; SEG29 PM2/LCD_SEG; SEG28 PM3/LCD_SEG; SEG27 PM4/LCD_SEG; SEG26 PM5/LCD_SEG; SEG25 PM6/LCD_SEG; SEG24 PM7/LCD_SEG; SEG{n} SEG{n}/LCD_SEG (n=0..23); BLINK1 SEG1/LCD_BLINK; BLINK0 SEG0/LCD_BLINK; BIAS1 BIAS1/LCD_BIAS; BIAS2 BIAS2/LCD_BIAS; VLCD VLCD/LCD_BIAS; CAPL CAPL/LCD_BIAS; CAPH CAPH/LCD_BIAS; COM0 COM0/LCD_COM or COM3/LCD_COM_SWP; COM1 COM1/LCD_COM or COM2/LCD_COM_SWP; COM2 COM2/LCD_COM or COM1/LCD_COM_SWP; COM3 COM3/LCD_COM or COM0/LCD_COM_SWP
FUSE at 0x00 in fuses (NVM_FUSES)
LOCKBIT at 0x00 in lockbits (NVM_LOCKBITS)
PROD_SIGNATURES at 0x00 in prod_signatures (NVM_PROD_SIGNATURES)

## Interrupts
1 OSC_OSCF — Oscillator Failure Interrupt (NMI)
2 PORTC_INT0 — External Interrupt 0
3 PORTC_INT1 — External Interrupt 1
4 PORTR_INT0 — External Interrupt 0
5 PORTR_INT1 — External Interrupt 1
6 DMA_CH0 — Channel 0 Interrupt
7 DMA_CH1 — Channel 1 Interrupt
10 RTC_OVF — Overflow Interrupt
11 RTC_COMP — Compare Interrupt
12 TWIC_TWIS — TWI Slave Interrupt
13 TWIC_TWIM — TWI Master Interrupt
14 TCC0_OVF — Overflow Interrupt
15 TCC0_ERR — Error Interrupt
16 TCC0_CCA — Compare or Capture A Interrupt
17 TCC0_CCB — Compare or Capture B Interrupt
18 TCC0_CCC — Compare or Capture C Interrupt
19 TCC0_CCD — Compare or Capture D Interrupt
20 TCC1_OVF — Overflow Interrupt
21 TCC1_ERR — Error Interrupt
22 TCC1_CCA — Compare or Capture A Interrupt
23 TCC1_CCB — Compare or Capture B Interrupt
24 SPIC_INT — SPI Interrupt
25 USARTC0_RXC — Reception Complete Interrupt
26 USARTC0_DRE — Data Register Empty Interrupt
27 USARTC0_TXC — Transmission Complete Interrupt
31 USB_BUSEVENT — SOF, suspend, resume, reset bus event interrupts, crc, underflow, overflow and stall error interrupts
32 USB_TRNCOMPL — Transaction complete interrupt
35 LCD_INT — LCD Interrupt
36 AES_INT — AES Interrupt
37 NVM_EE — EE Interrupt
38 NVM_SPM — SPM Interrupt
39 PORTB_INT0 — External Interrupt 0
40 PORTB_INT1 — External Interrupt 1
41 ACB_AC0 — AC0 Interrupt
42 ACB_AC1 — AC1 Interrupt
43 ACB_ACW — ACW Window Mode Interrupt
44 ADCB_CH0 — Interrupt 0
48 PORTD_INT0 — External Interrupt 0
49 PORTD_INT1 — External Interrupt 1
50 PORTG_INT0 — External Interrupt 0
51 PORTG_INT1 — External Interrupt 1
52 PORTM_INT0 — External Interrupt 0
53 PORTM_INT1 — External Interrupt 1
54 PORTE_INT0 — External Interrupt 0
55 PORTE_INT1 — External Interrupt 1
58 TCE0_OVF — Overflow Interrupt
59 TCE0_ERR — Error Interrupt
60 TCE0_CCA — Compare or Capture A Interrupt
61 TCE0_CCB — Compare or Capture B Interrupt
62 TCE0_CCC — Compare or Capture C Interrupt
63 TCE0_CCD — Compare or Capture D Interrupt
69 USARTE0_RXC — Reception Complete Interrupt
70 USARTE0_DRE — Data Register Empty Interrupt
71 USARTE0_TXC — Transmission Complete Interrupt
75 PORTA_INT0 — External Interrupt 0
76 PORTA_INT1 — External Interrupt 1
77 ACA_AC0 — AC0 Interrupt
78 ACA_AC1 — AC1 Interrupt
79 ACA_ACW — ACW Window Mode Interrupt
80 ADCA_CH0 — Interrupt 0

## Properties
SIGNATURES: JTAGID=0x0974D03F, SIGNATURE0=0x1E, SIGNATURE1=0x97, SIGNATURE2=0x4D

## Pinouts (pin number, pad)
QFP_100: 1 GND, 2 PC0, 3 PC1, 4 PC2, 5 PC3, 6 PC4, 7 PC5, 8 PC6, 9 PC7, 10 GND, 11 VCC, 12 PD0, 13 PD1, 14 PD2, 15 RESET, 16 PDI, 17 GND, 18 VCC, 19 PE0, 20 PE1, 21 PE2, 22 PE3, 23 PE4, 24 PE5, 25 PE6, 26 PE7, 27 GND, 28 VCC, 29 PG0, 30 PG1, 31 PG2, 32 PG3, 33 PG4, 34 PG5, 35 PG6, 36 PG7, 37 PM0, 38 PM1, 39 PM2, 40 PM3, 41 PM4, 42 PM5, 43 PM6, 44 PM7, 45 SEG23, 46 SEG22, 47 SEG21, 48 SEG20, 49 SEG19, 50 SEG18, 51 SEG17, 52 SEG16, 53 SEG15, 54 SEG14, 55 SEG13, 56 SEG12, 57 SEG11, 58 SEG10, 59 SEG9, 60 SEG8, 61 SEG7, 62 SEG6, 63 SEG5, 64 SEG4, 65 SEG3, 66 SEG2, 67 SEG1, 68 SEG0, 69 GND, 70 VCC, 71 BIAS1, 72 BIAS2, 73 VLCD, 74 CAPL, 75 CAPH, 76 COM0, 77 COM1, 78 COM2, 79 COM3, 80 PR0, 81 PR1, 82 PA0, 83 PA1, 84 PA2, 85 PA3, 86 PA4, 87 PA5, 88 PA6, 89 PA7, 90 AGND, 91 AVCC, 92 PB0, 93 PB1, 94 PB2, 95 PB3, 96 PB4, 97 PB5, 98 PB6, 99 PB7, 100 GND
BGA_100: A1 PC0, A2 VCC, A3 PB6, A4 PB2, A5 AVCC, A6 PA5, A7 PA1, A8 PR1, A9 COM2, A10 CAPH, B1 PC3, B2 GND, B3 PB7, B4 PB4, B5 AGND, B6 PA4, B7 PA0, B8 PR0, B9 COM1, B10 CAPL, C1 PC5, C2 PC4, C3 PC1, C4 PB5, C5 PA7, C6 PA3, C7 COM3, C8 COM0, C9 BIAS2, C10 BIAS1, D1 VCC, D2 GND, D3 PD0, D4 PC2, D5 PB0, D6 PA6, D7 SEG0, D8 VLCD, D9 GND, D10 VCC, E1 PD2, E2 RESET, E3 PD1, E4 PC6, E5 PB1, E6 PA2, E7 SEG1, E8 SEG4, E9 SEG3, E10 SEG2, F1 VCC, F2 GND, F3 PDI, F4 PC7, F5 PB3, F6 PM2, F7 SEG10, F8 SEG7, F9 SEG6, F10 SEG5, G1 PE2, G2 PE1, G3 PE3, G4 PE0, G5 PE4, G6 SEG23, G7 SEG15, G8 SEG13, G9 SEG9, G10 SEG8, H1 PE5, H2 PE6, H3 PG1, H4 PG4, H5 PG7, H6 PM5, H7 SEG21, H8 SEG18, H9 SEG12, H10 SEG11, J1 PE7, J2 PG0, J3 PG3, J4 PG6, J5 PM1, J6 PM4, J7 PM7, J8 SEG20, J9 SEG16, J10 SEG14, K1 GND, K2 VCC, K3 PG2, K4 PG5, K5 PM0, K6 PM3, K7 PM6, K8 SEG22, K9 SEG19, K10 SEG17
