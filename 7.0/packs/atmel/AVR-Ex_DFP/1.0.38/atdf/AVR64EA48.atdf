# AVR64EA48 device description
Architecture: AVR8X; Family: AVR
Programming and debug interfaces: UPDI
Registers are 8-bit, read-write, reset 0x0 unless marked. A register's access mark holds for its fields unless they carry their own. Offsets are from the block's base; lines under a group give offsets from that group; [hi:lo] are bit positions; {n}, {i} and the like mark numbered series; 'fields as' and 'values as' point back to an identical list; <NAME> marks a mode.

## Ordering variants
AVR64EA48: QFN48, up to 20 MHz, -40 to 125 C, 1.8 to 5.5 V

## Memory
data space: start 0x0000 size 0x10000, little endian
  0x00 IO size 0x103F io, rw
  0x1040 LOCKBITS size 0x04 lockbits, rw, page 0x4
  0x1050 FUSES size 0x10 fuses, rw, page 0x8
  0x1080 USER_SIGNATURES size 0x40 user_signatures, rw, page 0x40
  0x1100 SIGNATURES size 0x03 signatures, ro, page 0x80
  0x1103 PROD_SIGNATURES size 0x7D signatures, ro, page 0x80
  0x1400 EEPROM size 0x200 eeprom, rw, page 0x8
  0x6800 INTERNAL_SRAM size 0x1800 ram, rw
  0x8000 MAPPED_PROGMEM size 0x8000 other, rw, page 0x80
prog space: start 0x0000 size 0x10000, little endian
  0x00 PROGMEM size 0x10000 flash, rw, executable, page 0x80
  0x00 PROGMEM_NRWW size 0x2000 flash, rw, executable, page 0x80
  0x2000 PROGMEM_RWW size 0xE000 flash, rw, executable, page 0x80

## Peripheral instances (address, pins/pin function, parameters)
AC0 at 0x0680 (AC)
  pins: N0 PD3; N1 PD0; N2 PD7; N3 PC2; P0 PD2; P1 PE0; P2 PE2; P3 PD6; P4 PC3; OUT PA7 or PC6/AC0_ALT1
  pin routing set by: PORTMUX.ACROUTEA.AC0
AC1 at 0x0688 (AC)
  pins: N0 PD5; N1 PD0; N2 PD7; P0 PD2; P1 PD3; P2 PD4; P3 PD6; P4 PC3; OUT PA7 or PC6/AC1_ALT1
  pin routing set by: PORTMUX.ACROUTEA.AC1
ADC0 at 0x0600 (ADC)
  pins: AIN{n} PD{n}/AIN0 (n=0..7); AIN8 PE0/AIN0; AIN9 PE1/AIN0; AIN10 PE2/AIN0; AIN11 PE3/AIN0; AIN16 PF0/AIN0; AIN17 PF1/AIN0; AIN18 PF2/AIN0; AIN19 PF3/AIN0; AIN20 PF4/AIN0; AIN21 PF5/AIN0; AIN22 PA2/AIN0; AIN23 PA3/AIN0; AIN24 PA4/AIN0; AIN25 PA5/AIN0; AIN26 PA6/AIN0; AIN27 PA7/AIN0; AIN28 PC0/AIN0; AIN29 PC1/AIN0; AIN30 PC2/AIN0; AIN31 PC3/AIN0
BOD at 0x00A0
CCL at 0x01C0
  pins: LUT0_IN0 PA0/CCL_IN; LUT0_IN1 PA1/CCL_IN; LUT0_IN2 PA2/CCL_IN; LUT1_IN0 PC0/CCL_IN; LUT1_IN1 PC1/CCL_IN; LUT1_IN2 PC2/CCL_IN; LUT2_IN0 PD0/CCL_IN; LUT2_IN1 PD1/CCL_IN; LUT2_IN2 PD2/CCL_IN; LUT3_IN0 PF0/CCL_IN; LUT3_IN1 PF1/CCL_IN; LUT3_IN2 PF2/CCL_IN; LUT4_IN0 PB0/CCL_IN; LUT4_IN1 PB1/CCL_IN; LUT4_IN2 PB2/CCL_IN; LUT0_OUT PA3 or PA6/CCL_ALT1; LUT1_OUT PC3 or PC6/CCL_ALT1; LUT2_OUT PD3 or PD6/CCL_ALT1; LUT3_OUT PF3; LUT4_OUT PB3
  pin routing set by: PORTMUX.CCLROUTEA.LUT0, PORTMUX.CCLROUTEA.LUT1, PORTMUX.CCLROUTEA.LUT2, PORTMUX.CCLROUTEA.LUT3, PORTMUX.CCLROUTEA.LUT4
CLKCTRL at 0x0060
  pins: CLKOUT PA7; EXTCLK PA0; XTAL32K1 PF0/XOSC; XTAL32K2 PF1/XOSC; XTALHF1 PA0/XOSC; XTALHF2 PA1/XOSC
CPU at 0x0030
  parameters: CORE_VERSION=V4S
CPUINT at 0x0110
CRCSCAN at 0x0120
DAC0 at 0x06A0 (DAC)
  pins: OUT PD6
EVSYS at 0x0200
  pins: EVOUT0 PA2 or PA7/EVSYS_ALT1; EVOUT1 PB2; EVOUT2 PC2 or PC7/EVSYS_ALT1; EVOUT3 PD2 or PD7/EVSYS_ALT1; EVOUT4 PE2; EVOUT5 PF2 or PF7/EVSYS_ALT1
  pin routing set by: PORTMUX.EVSYSROUTEA.EVOUTA, PORTMUX.EVSYSROUTEA.EVOUTB, PORTMUX.EVSYSROUTEA.EVOUTC, PORTMUX.EVSYSROUTEA.EVOUTD, PORTMUX.EVSYSROUTEA.EVOUTE, PORTMUX.EVSYSROUTEA.EVOUTF
FUSE at 0x1050
GPR at 0x001C
LOCK at 0x1040
NVMCTRL at 0x1000
PORTA at 0x0400 (PORT)
  pins: PIN{n} PA{n}/IOPORT (n=0..7)
PORTB at 0x0420 (PORT)
  pins: PIN0 PB0/IOPORT; PIN1 PB1/IOPORT; PIN2 PB2/IOPORT; PIN3 PB3/IOPORT; PIN4 PB4/IOPORT; PIN5 PB5/IOPORT
PORTC at 0x0440 (PORT)
  pins: PIN{n} PC{n}/IOPORT (n=0..7)
PORTD at 0x0460 (PORT)
  pins: PIN{n} PD{n}/IOPORT (n=0..7)
PORTE at 0x0480 (PORT)
  pins: PIN0 PE0/IOPORT; PIN1 PE1/IOPORT; PIN2 PE2/IOPORT; PIN3 PE3/IOPORT
PORTF at 0x04A0 (PORT)
  pins: PIN{n} PF{n}/IOPORT (n=0..7)
PORTMUX at 0x05E0
RSTCTRL at 0x0040
  pins: RESET PF6/OTHER
RTC at 0x0140
SIGROW at 0x1100
SLPCTRL at 0x0050
SPI0 at 0x0940 (SPI)
  pins: MISO PA5 or PE1/SPI0_ALT1 or PA1/SPI0_ALT3 or PD5/SPI0_ALT4 or PC1/SPI0_ALT5 or PC1/SPI0_ALT6; MOSI PA4 or PE0/SPI0_ALT1 or PA0/SPI0_ALT3 or PD4/SPI0_ALT4 or PC0/SPI0_ALT5 or PC2/SPI0_ALT6; SCK PA6 or PE2/SPI0_ALT1 or PC0/SPI0_ALT3 or PD6/SPI0_ALT4 or PC2/SPI0_ALT5 or PC3/SPI0_ALT6; SS PA7 or PE3/SPI0_ALT1 or PC1/SPI0_ALT3 or PD7/SPI0_ALT4 or PC3/SPI0_ALT5 or PF7/SPI0_ALT6
  pin routing set by: PORTMUX.SPIROUTEA.SPI0
SYSCFG at 0x0F00
TCA0 at 0x0A00 (TCA)
  pins: WO0 PA0 or PB0/TCA0_ALT1 or PC0/TCA0_ALT2 or PD0/TCA0_ALT3 or PE0/TCA0_ALT4 or PF0/TCA0_ALT5; WO1 PA1 or PB1/TCA0_ALT1 or PC1/TCA0_ALT2 or PD1/TCA0_ALT3 or PE1/TCA0_ALT4 or PF1/TCA0_ALT5; WO2 PA2 or PB2/TCA0_ALT1 or PC2/TCA0_ALT2 or PD2/TCA0_ALT3 or PE2/TCA0_ALT4 or PF2/TCA0_ALT5; WO3 PA3 or PB3/TCA0_ALT1 or PC3/TCA0_ALT2 or PD3/TCA0_ALT3 or PE3/TCA0_ALT4 or PF3/TCA0_ALT5; WO4 PA4 or PB4/TCA0_ALT1 or PC4/TCA0_ALT2 or PD4/TCA0_ALT3 or PF4/TCA0_ALT5; WO5 PA5 or PB5/TCA0_ALT1 or PC5/TCA0_ALT2 or PD5/TCA0_ALT3 or PF5/TCA0_ALT5
  pin routing set by: PORTMUX.TCAROUTEA.TCA0
TCA1 at 0x0A40 (TCA)
  pins: WO0 PB0 or PC4/TCA1_ALT1 or PA4/TCA1_ALT4 or PD4/TCA1_ALT5; WO1 PB1 or PC5/TCA1_ALT1 or PA5/TCA1_ALT4 or PD5/TCA1_ALT5; WO2 PB2 or PC6/TCA1_ALT1 or PA6/TCA1_ALT4 or PD6/TCA1_ALT5; WO3 PB3; WO4 PB4; WO5 PB5
  pin routing set by: PORTMUX.TCAROUTEA.TCA1
TCB0 at 0x0B00 (TCB)
  pins: WO0 PA2 or PF4/TCB0_ALT1
  pin routing set by: PORTMUX.TCBROUTEA.TCB0
TCB1 at 0x0B10 (TCB)
  pins: WO0 PA3 or PF5/TCB1_ALT1
  pin routing set by: PORTMUX.TCBROUTEA.TCB1
TCB2 at 0x0B20 (TCB)
  pins: WO0 PC0 or PB4/TCB2_ALT1
  pin routing set by: PORTMUX.TCBROUTEA.TCB2
TCB3 at 0x0B30 (TCB)
  pins: WO0 PB5 or PC1/TCB3_ALT1
  pin routing set by: PORTMUX.TCBROUTEA.TCB3
TWI0 at 0x0900 (TWI)
  pins: SCL PA3/I2C0 or PA3/I2C0_ALT1 or PC3/I2C0_ALT2 or PA1/I2C0_ALT3; SCL_DUAL PC3/I2C0 or PC7/I2C0_ALT1 or PC7/I2C0_ALT2 or PC3/I2C0_ALT3; SDA PA2/I2C0 or PA2/I2C0_ALT1 or PC2/I2C0_ALT2 or PA0/I2C0_ALT3; SDA_DUAL PC2/I2C0 or PC6/I2C0_ALT1 or PC6/I2C0_ALT2 or PC2/I2C0_ALT3
  pin routing set by: PORTMUX.TWIROUTEA.TWI0
USART0 at 0x0800 (USART)
  pins: RXD PA1; TXD PA0; XCK PA2; XDIR PA3; RXD1 PA5/USART0_ALT1; TXD1 PA4/USART0_ALT1; XCK1 PA6/USART0_ALT1; XDIR1 PA7/USART0_ALT1; RXD2 PA3/USART0_ALT2; TXD2 PA2/USART0_ALT2; RXD3 PD5/USART0_ALT3; TXD3 PD4/USART0_ALT3; XCK3 PD6/USART0_ALT3; XDIR3 PD7/USART0_ALT3; RXD4 PC2/USART0_ALT4; TXD4 PC1/USART0_ALT4; XCK4 PC3/USART0_ALT4
  pin routing set by: PORTMUX.USARTROUTEA.USART0
USART1 at 0x0820 (USART)
  pins: RXD PC1 or PC5/USART1_ALT1 or PD7/USART1_ALT2; TXD PC0 or PC4/USART1_ALT1 or PD6/USART1_ALT2; XCK PC2 or PC6/USART1_ALT1; XDIR PC3 or PC7/USART1_ALT1
  pin routing set by: PORTMUX.USARTROUTEA.USART1
USART2 at 0x0840 (USART)
  pins: RXD PF1 or PF5/USART2_ALT1; TXD PF0 or PF4/USART2_ALT1; XCK PF2; XDIR PF3
  pin routing set by: PORTMUX.USARTROUTEA.USART2
USERROW at 0x1080
VPORTA at 0x0000 (VPORT)
VPORTB at 0x0004 (VPORT)
VPORTC at 0x0008 (VPORT)
VPORTD at 0x000C (VPORT)
VPORTE at 0x0010 (VPORT)
VPORTF at 0x0014 (VPORT)
VREF at 0x00B0
  pins: VREFA PD7/VREFA
WDT at 0x0100

## Interrupts
1 NMI (CRCSCAN)
2 VLM (BOD)
3 CFD (CLKCTRL)
4 CNT (RTC)
5 PIT (RTC)
6 CCL
7 PORT (PORTA)
8 LUNF (TCA0)
8 OVF (TCA0)
9 HUNF (TCA0)
10 CMP0 (TCA0)
10 LCMP0 (TCA0)
11 CMP1 (TCA0)
11 LCMP1 (TCA0)
12 CMP2 (TCA0)
12 LCMP2 (TCA0)
13 INT (TCB0)
14 INT (TCB1)
15 TWIS (TWI0)
16 TWIM (TWI0)
17 INT (SPI0)
18 RXC (USART0)
19 DRE (USART0)
20 TXC (USART0)
21 PORT (PORTD)
22 AC (AC0)
23 ERROR (ADC0)
24 RESRDY (ADC0)
25 SAMPRDY (ADC0)
26 AC (AC1)
27 PORT (PORTC)
28 INT (TCB2)
29 RXC (USART1)
30 DRE (USART1)
31 TXC (USART1)
32 PORT (PORTF)
33 EEREADY (NVMCTRL)
33 FLREADY (NVMCTRL)
33 NVMREADY (NVMCTRL)
34 RXC (USART2)
35 DRE (USART2)
36 TXC (USART2)
37 INT (TCB3)
38 LUNF (TCA1)
38 OVF (TCA1)
39 HUNF (TCA1)
40 CMP0 (TCA1)
40 LCMP0 (TCA1)
41 CMP1 (TCA1)
41 LCMP1 (TCA1)
42 CMP2 (TCA1)
42 LCMP2 (TCA1)
43 PORT (PORTE)
44 PORT (PORTB)

## Properties
OCD_FEATURES: BREAK_PIN=PF6, BREAK_PIN_ALT1=PF2
SIGNATURES: SIGNATURE0=0x1E, SIGNATURE1=0x96, SIGNATURE2=0x1E

## Pinouts (pin number, pad)
QFN48: 1 PA5, 2 PA6, 3 PA7, 4 PB0, 5 PB1, 6 PB2, 7 PB3, 8 PB4, 9 PB5, 10 PC0, 11 PC1, 12 PC2, 13 PC3, 14 VDD2, 15 GND2, 16 PC4, 17 PC5, 18 PC6, 19 PC7, 20 PD0, 21 PD1, 22 PD2, 23 PD3, 24 PD4, 25 PD5, 26 PD6, 27 PD7, 28 AVDD, 29 GND0, 30 PE0, 31 PE1, 32 PE2, 33 PE3, 34 PF0, 35 PF1, 36 PF2, 37 PF3, 38 PF4, 39 PF5, 40 PF6, 41 PF7, 42 VDD1, 43 GND1, 44 PA0, 45 PA1, 46 PA2, 47 PA3, 48 PA4
